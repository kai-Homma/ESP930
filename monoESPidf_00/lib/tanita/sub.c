// /****************************************************************************/
// /*																			*/
// /*							＜体組成計・FR-200L＞							*/
// /*																			*/
// /*		ファイル名		：	sub.c											*/
// /*																			*/
// /*		モジュール名称	：	共通関数										*/
// /*																			*/
// /*		作成年月日		：	2022/ 2/21	小山		BC333L_V10ベース		*/
// /*																			*/
// /*		変更履歴		：	2022/ 2/21	小山		key01					*/
// /*								キー配置変更								*/
// /*							2022/ 2/21	小山		spec01					*/
// /*								仕様変更									*/
// /*							2022/ 2/25	小山		rev01					*/
// /*								回帰式表変更（B41XDJ⇒B42(B)J）筋質点数追加	*/
// /*							2022/ 4/ 4	小山		step01					*/
// /*								ステップオン機能削除						*/
// /*							2022/ 4/ 4	小山		ble02					*/
// /*								BLE通信で調整・検査							*/
// /*							2022/ 4/11	小山		lcd02					*/
// /*								バックライト削除							*/
// /*							2022/ 4/19	小山		lcd01					*/
// /*								LCD削除										*/
// /*							2022/ 5/ 9	小山		item01					*/
// /*								測定項目変更								*/
// /*							2022/ 5/12	小山		voice01					*/
// /*								音声追加									*/
// /*							2022/ 5/26	小山		err01					*/
// /*								エラー情報送信追加							*/
// /*							2022/ 7/ 7	小山		imp01					*/
// /*								インピ測定変更（シングル⇒デュアル周波数）	*/
// /*																			*/
// /*					Copyright 2009-2022 TANITA Corporation					*/
// /*																			*/
// /****************************************************************************/

#include	"at_inc.h"					/* インクルードファイル				*/

// /****************************************************************************/
// /*		ＲＡＭ																*/
// /****************************************************************************/
// 

// /****************************************************************************/
// /*		ＲＯＭ																*/
// /****************************************************************************/
// 										/* 身長丸めテーブル					*/
// const	struct	HTROUND_TBL_T	HtRound_Tbl[UNIT_MAX] =
// {
// 	{	HEIT_CM_MAX,	{HEIT_CM_NOTCH,	HEIT_CM_NOTCH_HI}},
// 										/* cm(kg):	 ～220cm  目量0.5/1cm	*/
// 	{	HEIT_FI_MAX,	{HEIT_IN_NOTCH,	HEIT_IN_NOTCH_HI}},
// 										/* in(lb):	 ～7ft3in 目量0.5/0.5in	*/
// 	{	HEIT_FI_MAX,	{HEIT_IN_NOTCH,	HEIT_IN_NOTCH_HI}}
// 										/* in(st-lb):～7ft3in 目量0.5/0.5in	*/
// };

// //t025 add start
// const_c	Str_DName_Fr200l[BLE_NAME_SIZE] =
// 			{ 'F','R','-','2','0','0','L',' ' };
// 										/* DEvice Name（FR-200L用）			*/
// //t025 add end
// 

// /****************************************************************************/
// /*		プロトタイプ宣言													*/
// /****************************************************************************/
// void	ChkGrav(void);					/* 重力加速度チェック				*/
// void	ChkCountry(void);				/* 向け先チェック					*/
// /* step01 del start															*/
// /*void	ChkStpon(void);					 * ステップON閾値チェック			*/
// /* step01 del end															*/
// void	ChkImpConv(void);				/* インピ変換係数チェック			*/
// void	ChkTemp(void);					/* 温度補正値チェック				*/
// void	ChkZeroPort(void);				/* 0点ポートチェック				*/
// void	ChkArea(void);					/* 地域チェック						*/
// void	ChkUnit(void);					/* 単位チェック						*/
// //t025 add start
// void	ChkModel(void);					/* モデル名チェック					*/
// //t025 add end
// void	ShiftPsMng(void);				/* 測定データ管理情報シフト			*/
// uchar	SeekPsMng(void);				/* 個人管理情報空き検索				*/
// 

/****************************************************************************/
/*																			*/
/*		関数名			：	FtoS											*/
/*																			*/
/*		関数名称		：	float⇒short変換								*/
/*																			*/
/*		作成年月日		：	2009/ 5/14	小山								*/
/*																			*/
/*		単体試験履歴	：	2010/10/27	深田								*/
/*																			*/
/****************************************************************************/
uchar	FtoS(short *pOut, float fIn)
{
										/* pOut	:出力						*/
										/* fIn	:入力						*/
	if((fIn > (float)-32768) && (fIn < (float)32767))
	{
		if(fIn > (float)0)				/* 四捨五入							*/
		{
			*pOut = (short)(fIn + FLOAT_ROUND);
		}
		else
		{
			*pOut = (short)(fIn - FLOAT_ROUND);
		}
		return(OK);
	}
	return(NG);
}


// /****************************************************************************/
// /*																			*/
// /*		関数名			：	ConvAbs											*/
// /*																			*/
// /*		関数名称		：	絶対値変換										*/
// /*																			*/
// /*		作成年月日		：	2009/ 5/14	小山								*/
// /*																			*/
// /*		単体試験履歴	：	2010/12/10	深田								*/
// /*																			*/
// /****************************************************************************/
// char	ConvAbs(ushort *pVal)
// {
// 										/* pVal	:２の補数データへのポインタ	*/
// 	if(*pVal & (ushort)0x8000)			/* マイナス値の場合					*/
// 	{
// 		*pVal = -*pVal;					/* 絶対値変換						*/
// 		return('-');					/* マイナス符号返却					*/
// 	}

// 	return('+');						/* プラス符号返却					*/
// }
// 

// /****************************************************************************/
// /*																			*/
// /*		関数名			：	ConvAbsCast										*/
// /*																			*/
// /*		関数名称		：	絶対値変換キャスト								*/
// /*																			*/
// /*		作成年月日		：	2009/ 5/14	小山								*/
// /*																			*/
// /*		単体試験履歴	：	2010/12/10	深田								*/
// /*																			*/
// /****************************************************************************/
// char	ConvAbsCast(ulong *pOut, long lIn)
// {
// 										/* pOut	:出力データポインタ			*/
// 										/* lIn	:入力データ					*/

// 	char	cSign;						/* 符号								*/

// 	cSign = '+';						/* 符号プラス						*/

// 	if(lIn < (long)0)					/* 負数の場合						*/
// 	{
// 		lIn = -lIn;						/* 絶対値変換						*/
// 		cSign = '-';					/* 符号マイナス						*/
// 	}

// 	*pOut = (ulong)lIn;					/* キャスト							*/

// 	return(cSign);						/* 符号返却							*/
// }
// 

// /****************************************************************************/
// /*																			*/
// /*		関数名			：	DivRoundS										*/
// /*																			*/
// /*		関数名称		：	2バイトデータ除算(四捨五入)						*/
// /*																			*/
// /*		作成年月日		：	2009/ 5/14	小山								*/
// /*																			*/
// /*		単体試験履歴	：	2010/12/10	深田								*/
// /*																			*/
// /****************************************************************************/
// ushort	DivRoundS(ushort usValA, ushort usValB)
// {
// 										/* usValA	:割られる値				*/
// 										/* usValB	:割る値					*/
// 	ushort	usVal;						/* ワーク							*/

// 	usVal = (ushort)0;					/* ワーク初期化						*/

// 	if(usValB)							/* 割る値が0以外の場合				*/
// 	{
// 		usVal = (ushort)(((ulong)usValA + (ulong)(usValB / (ushort)2))
// 							/ (ulong)usValB);
// 										/* 除算								*/
// 	}
// 	return(usVal);						/* 除算結果(四捨五入)を返却			*/
// }
// 

// /****************************************************************************/
// /*																			*/
// /*		関数名			：	DivRoundL										*/
// /*																			*/
// /*		関数名称		：	4バイトデータ除算(四捨五入)						*/
// /*																			*/
// /*		作成年月日		：	2009/ 5/14	小山								*/
// /*																			*/
// /*		単体試験履歴	：	2010/12/10	深田								*/
// /*																			*/
// /****************************************************************************/
// ulong	DivRoundL(ulong ulValA, ulong ulValB)
// {
// 										/* ulValA	:割られる値				*/
// 										/* ulValB	:割る値					*/
// 	ulong	ulVal;						/* ワーク							*/

// 	ulVal = (ulong)0;					/* ワーク初期化						*/

// 	if(ulValB)							/* 割る値が0以外の場合				*/
// 	{
// 		ulVal = (ulong)(ulValB / (ulong)2);
// 		if(((float)ulValA + (float)ulVal) > FLOAT_ULONG_MAX)
// 		{								/* 演算結果がオーバーフローする場合	*/
// 			ulVal = (ulong)0;			/* 四捨五入しない					*/
// 		}
// 		ulVal = (ulong)((ulValA + ulVal) / ulValB);
// 										/* 除算								*/
// 	}

// 	return(ulVal);						/* 除算結果(四捨五入)を返却			*/
// }
// 

/****************************************************************************/
/*																			*/
/*		関数名			：	DivRoundSL										*/
/*																			*/
/*		関数名称		：	符号付き4バイトデータ除算(四捨五入)				*/
/*																			*/
/*		作成年月日		：	2009/ 5/14	小山								*/
/*																			*/
/*		単体試験履歴	：	2010/12/10	深田								*/
/*																			*/
/****************************************************************************/
long	DivRoundSL(long lValA, long lValB)
{
										/* lValA	:割られる値				*/
										/* lValB	:割る値					*/
	long	lValC;						/* ワークC							*/
	float	fValD;						/* ワークD							*/

	lValC = (long)0;					/* ワークC初期化					*/

	if((lValA != (long)0) && (lValB != (long)0))
	{									/* 入力値が0以外の場合				*/
		lValC = (long)(lValB / (long)2);
		if(((lValA > (long)0) && (lValB < (long)0)) ||
				((lValA < (long)0) && (lValB > (long)0)))
		{								/* 四捨五入の増分の符号設定			*/
			lValC = -lValC;
		}
		fValD = (float)((float)lValA + (float)lValC);
		if((fValD < (float)(-2.146E+9F)) || (fValD > (float)(2.146E+9F)))
		{								/* 演算結果がオーバーフローする場合	*/
			lValC = (long)0;			/* 四捨五入しない					*/
		}
		lValC = (long)((lValA + lValC) / lValB);
										/* 除算								*/
	}

	return(lValC);						/* 除算結果(四捨五入)を返却			*/
}


/****************************************************************************/
/*																			*/
/*		関数名			：	ImAdd											*/
/*																			*/
/*		関数名称		：	複素数加算										*/
/*																			*/
/*		作成年月日		：	2009/ 5/14	小山								*/
/*																			*/
/*		単体試験履歴	：	2010/12/10	深田								*/
/*																			*/
/*		((*pRe)+(*pIm)i) + (lRe+lImi) = ((*pRe)+lRe) + ((*pIm)+lIm)i		*/
/*																			*/
/****************************************************************************/
void	ImAdd(float *pRe, float *pIm, float fRe, float fIm)
{
										/* pRe	:演算結果の実部のポインタ	*/
										/* pIm	:演算結果の虚部のポインタ	*/
										/* fRe	:足す数の実部				*/
										/* fIm	:足す数の虚部				*/

	*pRe += fRe;						/* 実部の計算						*/
	*pIm += fIm;						/* 虚部の計算						*/
}


/****************************************************************************/
/*																			*/
/*		関数名			：	ImMul											*/
/*																			*/
/*		関数名称		：	複素数乗算										*/
/*																			*/
/*		作成年月日		：	2009/ 5/14	小山								*/
/*																			*/
/*		単体試験履歴	：	2010/12/10	深田								*/
/*																			*/
/*		((*pRe)+(*pIm)i) * (fRe+fImi) =										*/
/*				((*pRe)*fRe - (*pIm)*fIm) + ((*pRe)*fIm + (*pIm)*fRe)i		*/
/*																			*/
/****************************************************************************/
void	ImMul(float *pRe, float *pIm, float fRe, float fIm)
{
										/* pRe	:演算結果の実部のポインタ	*/
										/* pIm	:演算結果の虚部のポインタ	*/
										/* fRe	:掛ける数の実部				*/
										/* fIm	:掛ける数の虚部				*/

	float	fVal;						/* ワーク							*/

	fVal = (float)((*pRe)*fRe - (*pIm)*fIm);
										/* 実部の計算						*/
	*pIm = (float)((*pRe)*fIm + (*pIm)*fRe);
										/* 虚部の計算						*/
	*pRe = fVal;
}


/****************************************************************************/
/*																			*/
/*		関数名			：	ImDiv											*/
/*																			*/
/*		関数名称		：	複素数除算										*/
/*																			*/
/*		作成年月日		：	2009/ 5/14	小山								*/
/*																			*/
/*		単体試験履歴	：	2010/12/10	深田								*/
/*																			*/
/*		((*pRe)+(*pIm)i) / (fRe+fImi) =										*/
/*				((*pRe)*fRe + (*pIm)*fIm) + ((*pIm)*fRe - (*pRe)*fIm)i		*/
/*				------------------------------------------------------		*/
/*								  fRe*fRe + fIm*fIm							*/
/*																			*/
/****************************************************************************/
void	ImDiv(float *pRe, float *pIm, float fRe, float fIm)
{
										/* pRe	:演算結果の実部のポインタ	*/
										/* pIm	:演算結果の虚部のポインタ	*/
										/* fRe	:割る数の実部				*/
										/* fIm	:割る数の虚部				*/

	float	fDiv;						/* ワーク							*/
	float	fTmp;

	fDiv = (float)((fRe*fRe) + (fIm*fIm));
										/* 分母								*/
	fTmp = (float)((((*pRe)*fRe) + ((*pIm)*fIm)) / fDiv);
										/* 実部								*/
	*pIm = (float)((((*pIm)*fRe) - ((*pRe)*fIm)) / fDiv);
										/* 虚部								*/
	*pRe = fTmp;
}


// /****************************************************************************/
// /*																			*/
// /*		関数名			：	RoundS											*/
// /*																			*/
// /*		関数名称		：	2バイトデータ丸め処理							*/
// /*																			*/
// /*		作成年月日		：	2009/ 5/14	小山								*/
// /*																			*/
// /*		単体試験履歴	：	2010/12/10	深田								*/
// /*																			*/
// /****************************************************************************/
// ushort	RoundS(ushort usValA, ushort usValB)
// {
// 										/* usValA	:対象データ				*/
// 										/* usValB	:丸め値					*/
// 	ushort	usVal;						/* ワーク							*/

// 	usVal = DivRoundS(usValA, usValB);	/* 除算								*/

// 	if(usValB && (ulong)((ulong)usVal * (ulong)usValB) > (ulong)0xFFFF)
// 	{									/* 演算結果がオーバーフローする場合	*/
// 		usVal = (ushort)(usValA / usValB);
// 										/* 四捨五入しない					*/
// 	}

// 	usVal *= usValB;					/* 丸め演算							*/

// 	return(usVal);						/* 除算結果(四捨五入)の分解能を戻し	*/
// 										/* 返却								*/
// }
// 

// /****************************************************************************/
// /*																			*/
// /*		関数名			：	RoundHt											*/
// /*																			*/
// /*		関数名称		：	身長丸め										*/
// /*																			*/
// /*		作成年月日		：	2010/ 8/19	深田								*/
// /*																			*/
// /*		単体試験履歴	：	2013/ 3/28	小山								*/
// /*																			*/
// /****************************************************************************/
// ushort	RoundHt(ushort usHt)
// {
// 										/* usHt		:身長					*/

// 	const	struct	HTROUND_TBL_T	*pTbl;
// 										/* テーブルへのポインタ				*/
// 	ushort	usMin;						/* 最小値							*/
// 	uchar	uc1cm;						/* 目量 0/0.5cm 1/1cm				*/

// 	pTbl = &HtRound_Tbl[SYS.INF.UNIT];	/* ポインタ設定						*/
// 	usMin = GetHtMin(SYS.INF.UNIT);		/* 最小値設定						*/
// 	uc1cm = GetHtNotch(SYS.INF.COUNTRY);/* 目量設定							*/

// 	if(usHt < usMin)					/* 範囲チェック						*/
// 	{
// 		usHt = usMin;
// 	}
// 	else if(usHt > (pTbl->usMAX))
// 	{
// 		usHt = pTbl->usMAX;
// 	}

// 	return(RoundS(usHt, pTbl->usROUND[uc1cm]));
// 										/* 丸め身長返却						*/
// }
// 

// /****************************************************************************/
// /*																			*/
// /*		関数名			：	RoundWt											*/
// /*																			*/
// /*		関数名称		：	荷重丸め										*/
// /*																			*/
// /*		作成年月日		：	2010/ 8/19	深田								*/
// /*																			*/
// /*		単体試験履歴	：	2014/  /										*/
// /*																			*/
// /****************************************************************************/
// ushort	RoundWt(ushort usWt, uchar uc100g)
// {
// 										/* usWt		:荷重 max=59400cnt		*/
// 										/* uc100g	:目量 0/50g 1/100g		*/
// 	const	struct	WTROUND_TBL_T	*pTbl;
// 										/* テーブルへのポインタ				*/

// 	if(SYS.INF.UNIT != UNIT_KG)			/* 単位lb,st-lbの場合				*/
// 	{
// 		usWt = (ushort)(((ulong)usWt * (ulong)0x10000) / (ulong)G_TO_LB_CPL);
// 										/* kg⇒lb変換						*/
// 										/* ※直後に丸め処理を行う為			*/
// 	}									/*   ここでは四捨五入の必要は無い	*/

// 	pTbl = &WtRound_Tbl[SYS.INF.UNIT];	/* ポインタ設定						*/

// 	if(SYS.INF.SPECB.BIT.WT_DUAL && (usWt >= pTbl->usBORDER))
// 	{									/* 目量更新							*/
// 		uc100g++;
// 	}

// 	return((ushort)(RoundS(usWt, (ushort)pTbl->ucROUND[uc100g])
// 							/ WtDsp_Tbl[SYS.INF.UNIT].usFIGMIN));
// 										/* 荷重データ丸め値返却				*/
// 										/* kg		1cnt=5g	   ⇒1cnt=0.01kg*/
// 										/* lb,st-lb	1cnt=0.01lb⇒1cnt=0.1lb	*/
// }
// 

// /****************************************************************************/
// /*																			*/
// /*		関数名			：	RoundFtoS										*/
// /*																			*/
// /*		関数名称		：	float⇒ushort丸め								*/
// /*																			*/
// /*		作成年月日		：	2009/ 6/ 2	深田								*/
// /*																			*/
// /*		単体試験履歴	：	2010/12/13	深田								*/
// /*																			*/
// /****************************************************************************/
// ushort	RoundFtoS(float fIn, uchar ucMagni)
// {
// 										/* fIn		:入力データ				*/
// 										/* ucMagni	:倍率					*/
// 	return((ushort)((fIn * (float)ucMagni) + FLOAT_ROUND));
// }
// 

// /****************************************************************************/
// /*																			*/
// /*		関数名			：	StoreData										*/
// /*																			*/
// /*		関数名称		：	カウントデータ蓄積								*/
// /*																			*/
// /*		作成年月日		：	2009/ 5/14	小山								*/
// /*																			*/
// /*		単体試験履歴	：	2010/12/13	深田								*/
// /*																			*/
// /****************************************************************************/
// uchar	StoreData(ulong ulSrc, ulong *pNew, ulong *pOld)
// {
// 										/* ulSrc:最新データ					*/
// 										/* pNew	:最新バッファへのポインタ	*/
// 										/* pOld	:過去バッファへのポインタ	*/
// 	uchar	ucRet;						/* リターンコード					*/

// 	ucRet = OK;							/* リターンコードＯＫ				*/

// 	for(; pOld > pNew; pOld--)
// 	{
// 		*pOld = *(pOld - 1);			/* 過去バッファをシフト				*/

// 		if(!(*pOld))					/* 過去バッファ中に					*/
// 		{								/* 未測定データが含まれる場合		*/
// 			ucRet = NG;					/* リターンコードＮＧ				*/
// 		}
// 	}

// 	*pNew = ulSrc;						/* 最新データ設定					*/

// 	return(ucRet);						/* リターンコード返却				*/
// }
// 

/****************************************************************************/
/*																			*/
/*		関数名			：	StoreDataSL										*/
/*																			*/
/*		関数名称		：	long型カウントデータ蓄積						*/
/*																			*/
/*		作成年月日		：	2009/ 5/14	小山								*/
/*																			*/
/*		単体試験履歴	：	2010/12/13	深田								*/
/*																			*/
/****************************************************************************/
void	StoreDataSL(long lSrc, long *pNew, long *pOld)
{
										/* lSrc:最新データ					*/
										/* pNew	:最新バッファへのポインタ	*/
										/* pOld	:過去バッファへのポインタ	*/
	for(; pOld > pNew; pOld--)
	{
		*pOld = *(pOld - 1);			/* 過去バッファをシフト				*/
	}

	*pNew = lSrc;						/* 最新データ設定					*/
}


// /****************************************************************************/
// /*																			*/
// /*		関数名			：	SumData											*/
// /*																			*/
// /*		関数名称		：	カウントデータ積算								*/
// /*																			*/
// /*		作成年月日		：	2009/ 5/14	小山								*/
// /*																			*/
// /*		単体試験履歴	：	2010/12/13	深田								*/
// /*																			*/
// /****************************************************************************/
// ulong	SumData(uchar ucSize, ulong *pData)
// {
// 										/* ucSize	:入力データサイズ		*/
// 										/* pData	:入力データへのポインタ	*/
// 	ulong	ulSum;						/* ulSum	:積算データ				*/

// 	ulSum = (ulong)0;					/* 積算データ初期化					*/

// 	for(; ucSize > (uchar)0 ; ucSize--, pData++)
// 	{
// 		ulSum += (*pData);				/* 入力データサイズ分のデータを加算	*/
// 	}

// 	return(ulSum);						/* 積算データ返却					*/
// }
// 

/****************************************************************************/
/*																			*/
/*		関数名			：	SumDataSL										*/
/*																			*/
/*		関数名称		：	long型カウントデータ積算						*/
/*																			*/
/*		作成年月日		：	2009/ 5/14	小山								*/
/*																			*/
/*		単体試験履歴	：	2010/12/13	深田								*/
/*																			*/
/****************************************************************************/
long	SumDataSL(uchar ucSize, long *pData)
{
										/* ucSize	:入力データサイズ		*/
										/* pData	:入力データへのポインタ	*/
	long	lSum;						/* lSum		:積算データ				*/

	lSum = (long)0;						/* 積算データ初期化					*/

	for(; ucSize > (uchar)0 ; ucSize--, pData++)
	{
		lSum += (*pData);				/* 入力データサイズ分のデータを加算	*/
	}

	return(lSum);						/* 積算データ返却					*/
}


// /****************************************************************************/
// /*																			*/
// /*		関数名			：	AvgData											*/
// /*																			*/
// /*		関数名称		：	カウントデータ平均								*/
// /*																			*/
// /*		作成年月日		：	2009/ 5/14	小山								*/
// /*																			*/
// /*		単体試験履歴	：	2010/12/13	深田								*/
// /*																			*/
// /****************************************************************************/
// ulong	AvgData(uchar ucRound)
// {
// 										/* ucRound	:カウント丸め値			*/
// 	ulong	ulAvg;						/* 平均データ						*/
// 	uchar	ucAvgCnt;					/* 平均回数							*/

// 	ucAvgCnt = (uchar)((MEAS.ucAVGCNT < ADC_AVG_MAX)
// 						? (MEAS.ucAVGCNT + (uchar)1) : ADC_AVG_MAX);
// 										/* 平均回数設定						*/
// 	ulAvg = SumData(ucAvgCnt, &ADC.WT.ulAVG[0]);
// 										/* カウントデータ積算				*/

// 	return(DivRoundL(ulAvg, (ulong)(ucAvgCnt * ucRound)));
// 										/* 平均データ返却(四捨五入)			*/
// }
// 

/****************************************************************************/
/*																			*/
/*		関数名			：	AvgDataSL										*/
/*																			*/
/*		関数名称		：	long型カウントデータ平均						*/
/*																			*/
/*		作成年月日		：	2009/ 5/14	小山								*/
/*																			*/
/*		単体試験履歴	：	2010/12/13	深田								*/
/*																			*/
/****************************************************************************/
long	AvgDataSL(uchar ucCnt, uchar ucSize, ushort usRound, long *pData)
{
										/* ucCnt	:平均回数				*/
										/* ucSize	:入力データサイズ		*/
										/* usRound	:丸め値					*/
										/* pData	:入力データへのポインタ	*/

	long	lAvg;						/* 平均データ						*/

	ucCnt = (uchar)((ucCnt < ucSize) ? (uchar)(ucCnt + 1) : ucSize);
										/* 平均回数更新						*/
	lAvg = SumDataSL(ucCnt, pData);

	return(DivRoundSL(lAvg, (long)((ushort)ucCnt * usRound)));
										/* 平均データ返却(四捨五入)			*/
}


// /****************************************************************************/
// /*																			*/
// /*		関数名			：	GetChkSum										*/
// /*																			*/
// /*		関数名称		：	チェックサム取得								*/
// /*																			*/
// /*		作成年月日		：	2009/ 8/26	小山								*/
// /*																			*/
// /*		単体試験履歴	：	2010/12/13	深田								*/
// /*																			*/
// /****************************************************************************/
// uchar	GetChkSum(void *pData, uchar ucLen)
// {
// 										/* pData	:データポインタ			*/
// 										/* ucSize	:データサイズ			*/

// 	uchar	ucSum;						/* チェックサム						*/

// 	ucSum = (uchar)0;					/* チェックサム初期化				*/

// 	for(; ucLen > (uchar)0; ucLen--)	/* チェックサム計算					*/
// 	{
// 		ucSum += *(uchar*)pData;
// 		pData = (void*)(((uchar*)pData) + 1);
// 	}

// 	return((uchar)(ucSum ^ (uchar)0xFF));
// 										/* チェックサム(反転)返却			*/
// }
// 

// //lcd01 del start
// /****************************************************************************/
// /*																			*/
// /*		関数名			：	HexToDec										*/
// /*																			*/
// /*		関数名称		：	16進⇒10進変換(uchar)							*/
// /*																			*/
// /*		作成年月日		：	2009/ 8/26	小山								*/
// /*																			*/
// /*		単体試験履歴	：	2010/12/13	深田								*/
// /*																			*/
// /****************************************************************************/
// //void	HexToDec(uchar ucIn, char *pOut, uchar ucLen, uchar ucFig)
// //{
// //										/* ucIn		:入力データ				*/
// //										/* pOut		:出力データへのポインタ	*/
// //										/* ucLen	:出力データ長			*/
// //										/* ucFig	:出力データゼロサプ桁	*/
// //
// //	HexToDecL((ulong)ucIn, pOut, ucLen, ucFig);
// //										/* ＲＯＭ削減対策					*/
// //}
// //
// //
// /****************************************************************************/
// /*																			*/
// /*		関数名			：	HexToDecS										*/
// /*																			*/
// /*		関数名称		：	16進⇒10進変換(ushort)							*/
// /*																			*/
// /*		作成年月日		：	2009/ 8/26	小山								*/
// /*																			*/
// /*		単体試験履歴	：	2010/12/13	深田								*/
// /*																			*/
// /****************************************************************************/
// //void	HexToDecS(ushort usIn, char *pOut, uchar ucLen, uchar ucFig)
// //{
// //										/* usIn		:入力データ				*/
// //										/* pOut		:出力データへのポインタ	*/
// //										/* ucLen	:出力データ長			*/
// //										/* ucFig	:出力データゼロサプ桁	*/
// //
// //	HexToDecL((ulong)usIn, pOut, ucLen, ucFig);
// //										/* ＲＯＭ削減対策					*/
// //}
// //
// //
// /****************************************************************************/
// /*																			*/
// /*		関数名			：	HexToDecL										*/
// /*																			*/
// /*		関数名称		：	16進⇒10進変換(ulong)							*/
// /*																			*/
// /*		作成年月日		：	2009/ 8/26	小山								*/
// /*																			*/
// /*		単体試験履歴	：	2010/12/13	深田								*/
// /*																			*/
// /****************************************************************************/
// //void	HexToDecL(ulong ulIn, char *pOut, uchar ucLen, uchar ucFig)
// //{
// //										/* ulIn		:入力データ				*/
// //										/* pOut		:出力データへのポインタ	*/
// //										/* ucLen	:出力データ長			*/
// //										/* ucFig	:出力データゼロサプ桁	*/
// //
// //	pOut += ucLen;						/* 出力データ末端のアドレスを設定	*/
// //	pOut--;
// //
// //	while(ucLen--)						/* 出力データ長のサイズで編集		*/
// //	{
// //		*pOut = (char)((char)(ulIn % (ulong)10) + '0');
// //										/* アスキーコードを設定				*/
// //		ulIn /= (ulong)10;				/* 上位桁へ							*/
// //		pOut--;
// //	}
// //
// //	if(!ulIn)
// //	{
// //		while((ucFig--) && (*(++pOut) == '0'))
// //		{								/* 最上位桁無しかつゼロサプ桁有り	*/
// //			*pOut = ' ';				/* かつ'0'の場合、' 'に変換する		*/
// //		}
// //	}
// //}
// //
// //
// /****************************************************************************/
// /*																			*/
// /*		関数名			：	HexToAscS										*/
// /*																			*/
// /*		関数名称		：	16進⇒アスキー変換(ushort)						*/
// /*																			*/
// /*		作成年月日		：	2009/ 8/26	小山								*/
// /*																			*/
// /*		単体試験履歴	：	2010/12/13	深田								*/
// /*																			*/
// /****************************************************************************/
// //void	HexToAscS(ushort usIn, char *pOut, uchar ucLen)
// //{
// //										/* usIn		:入力データ				*/
// //										/* pOut		:出力データへのポインタ	*/
// //										/* ucLen	:出力データ長			*/
// //	uchar	ucBufIn[2];					/* 入力バッファ						*/
// //	uchar	ucBufOut[4];				/* 出力バッファ						*/
// //
// //	if(!ucLen)							/* 出力データ長が0の場合			*/
// //	{
// //		ucLen = (uchar)1;				/* 出力データ長＝1					*/
// //	}
// //	else if(ucLen > (uchar)sizeof(ucBufOut))
// //	{									/* 出力データ長＞4の場合			*/
// //		ucLen = (uchar)sizeof(ucBufOut);/* 出力データ長＝4					*/
// //	}
// //
// //	ucBufIn[0] = (uchar)usIn;			/* 入力バッファ設定					*/
// //	ucBufIn[1] = (uchar)(usIn >> 8);
// //
// //	Conv8BitTo4Bit(&ucBufOut[0], &ucBufIn[0], (uchar)2);
// //										/* 8ビット2バイト⇒4ビット4バイト	*/
// //	HexToAsc((uchar*)(ucBufOut + sizeof(ucBufOut) - ucLen), pOut, ucLen);
// //										/* 16進⇒アスキー変換(uchar)		*/
// //}
// //
// //
// /****************************************************************************/
// /*																			*/
// /*		関数名			：	HexToAsc										*/
// /*																			*/
// /*		関数名称		：	16進⇒アスキー変換(uchar)						*/
// /*																			*/
// /*		作成年月日		：	2009/ 8/26	小山								*/
// /*																			*/
// /*		単体試験履歴	：	2010/12/13	深田								*/
// /*																			*/
// /****************************************************************************/
// //void	HexToAsc(uchar *pIn, char *pOut, uchar ucLen)
// //{
// //										/* pIn		:入力データへのポインタ	*/
// //										/* pOut		:出力データへのポインタ	*/
// //										/* ucLen	:出力データ長			*/
// //	for(; ucLen > (uchar)0; ucLen--, pIn++, pOut++)
// //	{									/* 出力データ長分ループ				*/
// //		*pOut = (char)((*pIn) +
// //			(uchar)(((*pIn) < (uchar)CHAR_A) ? '0' : ('A' - (char)CHAR_A)));
// //	}									/* 16進⇒アスキー変換				*/
// //}
// //
// //lcd01 del end

// /****************************************************************************/
// /*																			*/
// /*		関数名			：	Conv8BitTo4Bit									*/
// /*																			*/
// /*		関数名称		：	8ビット1～2バイト⇒4ビット2～4バイト			*/
// /*																			*/
// /*		作成年月日		：	2009/ 8/26	小山								*/
// /*																			*/
// /*		単体試験履歴	：	2010/12/13	深田								*/
// /*																			*/
// /****************************************************************************/
// void	Conv8BitTo4Bit(uchar *pOut, uchar *pIn, uchar ucLen)
// {
// 										/* pOut		:出力データへのポインタ	*/
// 										/* pIn		:入力データへのポインタ	*/
// 										/* ucLen	:データ長				*/
// 	uchar	ucCnt;						/* ローカルカウンタ					*/

// 	if(ucLen != (uchar)1)				/* データ長が1バイト以外の場合		*/
// 	{
// 		ucLen = (uchar)2;				/* データ長を2バイトに設定			*/
// 		pIn++;							/* 上位バイトからデータ変換			*/
// 	}

// 	for(ucCnt = ucLen; ucCnt > (uchar)0; ucCnt--, pIn--)
// 	{
// 		*pOut = (uchar)(((*pIn) >> 4) & (uchar)0x0F);
// 		pOut++;							/* 上位4ビット取得					*/
// 		*pOut = (uchar)((*pIn) & (uchar)0x0F);
// 		pOut++;							/* 下位4ビット取得					*/
// 	}
// }
// 

// /****************************************************************************/
// /*																			*/
// /*		関数名			：	Conv4BitTo8Bit									*/
// /*																			*/
// /*		関数名称		：	4ビット4バイト⇒8ビット2バイト					*/
// /*																			*/
// /*		作成年月日		：	2009/ 5/14	小山								*/
// /*																			*/
// /*		単体試験履歴	：	2010/12/13	深田								*/
// /*																			*/
// /****************************************************************************/
// void	Conv4BitTo8Bit(uchar *pOut, uchar *pIn)
// {
// 										/* pOut		:出力データへのポインタ	*/
// 										/* pIn		:入力データへのポインタ	*/
// 	uchar	ucCnt;						/* ローカルカウンタ					*/
// 	uchar	ucWork;						/* 汎用ワーク						*/

// 	pOut++;								/* 上位バイトからデータ変換			*/
// 	for(ucCnt = (uchar)2; ucCnt > (uchar)0; ucCnt--, pOut--)
// 	{
// 		ucWork = (uchar)(((*pIn) << 4) & (uchar)0xF0);
// 		pIn++;							/* 上位4ビット設定					*/
// 		*pOut = (uchar)(ucWork | ((*pIn) & (uchar)0x0F));
// 		pIn++;							/* 下位4ビット設定					*/
// 	}
// }
// 

// /****************************************************************************/
// /*																			*/
// /*		関数名			：	CalSub											*/
// /*																			*/
// /*		関数名称		：	差計算（ushort型データ）						*/
// /*																			*/
// /*		作成年月日		：	2009/ 5/26	小山								*/
// /*																			*/
// /*		単体試験履歴	：	2010/12/ 9	深田								*/
// /*																			*/
// /****************************************************************************/
// ushort	CalSub(ushort usThis, ushort usLast)
// {
// 										/* usThis	: 今回値				*/
// 										/* usLast	: 前回値				*/

// 	ushort	usSub;						/* 差								*/

// 	if(usThis >= usLast)				/* 今回値≧前回値の場合				*/
// 	{
// 		usSub = (ushort)(usThis - usLast);
// 	}
// 	else								/* 今回値＜前回値の場合				*/
// 	{
// 		usSub = (ushort)(usLast - usThis);
// 	}
// 	return(usSub);						/* 差を返却							*/
// }
// 

// /****************************************************************************/
// /*																			*/
// /*		関数名			：	CalSubL											*/
// /*																			*/
// /*		関数名称		：	差計算（ulong型データ）							*/
// /*																			*/
// /*		作成年月日		：	2009/ 5/26	小山								*/
// /*																			*/
// /*		単体試験履歴	：	2010/12/ 9	深田								*/
// /*																			*/
// /****************************************************************************/
// ulong	CalSubL(ulong ulThis, ulong ulLast)
// {
// 										/* ulThis	: 今回値				*/
// 										/* ulLast	: 前回値				*/

// 	ulong	ulSub;						/* 差								*/

// 	if(ulThis >= ulLast)				/* 今回値≧前回値の場合				*/
// 	{
// 		ulSub = (ulong)(ulThis - ulLast);
// 	}
// 	else								/* 今回値＜前回値の場合				*/
// 	{
// 		ulSub = (ulong)(ulLast - ulThis);
// 	}
// 	return(ulSub);						/* 差を返却							*/
// }
// 

// /****************************************************************************/
// /*																			*/
// /*		関数名			：	RoundFtoL										*/
// /*																			*/
// /*		関数名称		：	float⇒ulong丸め								*/
// /*																			*/
// /*		作成年月日		：	2016/ 4/25	高橋								*/
// /*																			*/
// /*		単体試験履歴	：	2018/ 7/20	小山								*/
// /*																			*/
// /****************************************************************************/
// ulong	RoundFtoL(float fIn, uchar ucMagni)
// {
// 										/* fIn		:入力データ				*/
// 										/* ucMagni	:倍率					*/

// 	return((ulong)((fIn * (float)ucMagni) + FLOAT_ROUND));
// }
// 

// /****************************************************************************/
// /*																			*/
// /*		関数名			：	ConvfAbs										*/
// /*																			*/
// /*		関数名称		：	絶対値変換(float型)								*/
// /*																			*/
// /*		作成年月日		：	2012/ 7/ 4	鈴木								*/
// /*																			*/
// /*		単体試験履歴	：	2012/ 7/27	鈴木								*/
// /*																			*/
// /****************************************************************************/
// float	ConvfAbs(float	fVal)
// {
// 										/* pVal	：変換前データポインタ		*/
// 	if(fVal < (float)0)
// 	{									/* マイナスの場合					*/
// 		return(-fVal);					/* 絶対値変換						*/
// 	}
// 	return(fVal);						/* そのまま返却						*/
// }
// 

// /****************************************************************************/
// /*																			*/
// /*		関数名			：	StsChg											*/
// /*																			*/
// /*		関数名称		：	状態遷移										*/
// /*																			*/
// /*		作成年月日		：	2009/ 5/14	小山								*/
// /*																			*/
// /*		単体試験履歴	：	2022/  /										*/
// /*																			*/
// /****************************************************************************/
// void	StsChg(enum MSTS_ID MSts)
// {
// 										/* MSts	:メイン状態					*/

// 	ReqTmrAtOff(TM_STOP);				/* オートオフタイマ(停止)			*/
// 	ReqTmr0(TM_STOP);					/* タイマ0停止						*/
// 	ReqTmr1(TM_STOP);					/* タイマ1停止						*/
// 	ReqTmr2(TM_STOP);					/* タイマ2停止						*/
// 	ReqTmr3(TM_STOP);					/* タイマ3停止						*/
// 	ReqTmr4(TM_STOP);					/* タイマ4停止						*/

// 	if(SYS.INF.ucRENEW == RENEW_NONE)	/* データ更新が無い場合				*/
// 	{
// 		s_memset(&FUNC, (uchar)0, sizeof(FUNC));
// 										/* ファンクション情報初期化			*/
// 	}

// //ble02 chg start
// //	if((MTR.MSTS >= MSTS_NTC) && (MTR.MSTS < MSTS_CNT)
// 	if((MSTS_NTC <= MTR.MSTS) && (MTR.MSTS <= MSTS_ITEM)
// //ble02 chg end
// 		&& (MSts == MSTS_POFF))
// 										/* 通知画面～項目表示順設定からの	*/
// 	{									/* 電源OFF遷移の場合				*/

// 		if(BLE.ucCONECT)				/* 接続中の場合						*/
// 		{
// 			if(BleComSnd(BLE_INIT) == NG)
// 			{							/* BLEモジュール初期化				*/
// 				m_blepoweroff();		/* BLE電源オフ						*/
// 			}
// 			else
// 			{
// 				m_delay(BLE_DELAY_RST);	/* ディレイ							*/
// 										/* ※接続中は初期化（切断）してから	*/
// 				BleSoftRst();			/* BLEモジュールリセット			*/
// 			}
// 		}

// 		MSts = MSTS_SAVE;				/* データ保存へ遷移					*/
// 	}

// //ble02 chg start
// //	if(!((MSts == MSTS_POFF)
// //		|| ((MSts == MSTS_CNT) && (MTR.MSTS == MSTS_ADJ))))
// //	{									/* 電源OFFまたは					*/
// //										/* 調整⇒カウントモード以外の場合	*/
// 	if(MSts != MSTS_POFF)
// 	{									/* 電源OFF以外の場合				*/
// //ble02 chg end
// 		INT.BIT.FINIT = ON;				/* ファンクション初期割込み設定		*/
// 	}
// //voice01 add start
// 	else if((MTR.MSTS > MSTS_PON) && !VOICE.ucBUZZOFF)
// 	{									/* 電源ON⇒電源OFFの場合			*/
// 		if(Set_Volume_Bz(SYS.INF.BUZZ) == NG)
// 		{								/* ブザー音量設定					*/
// 		}
// 		Req_Buzz(BUZZ_TYPE_END);		/* ブザーOFF時						*/
// 		while(Chk_VoSts(VSTS_CHK_CH0) == NG)
// 		{
// 		}								/* 発声停止完了まで待機				*/
// 	}
// //voice01 add end

// 	MTR.MSTS = MSts;					/* メイン状態設定					*/
// 	MTR.SSTS = SSTS_INIT;				/* サブ状態＝初期					*/
// }
// 

// /****************************************************************************/
// /*																			*/
// /*		関数名			：	StsChgTerm										*/
// /*																			*/
// /*		関数名称		：	条件付き状態遷移								*/
// /*																			*/
// /*		作成年月日		：	2009/ 5/14	小山								*/
// /*																			*/
// /*		単体試験履歴	：	2022/  /										*/
// /*																			*/
// /****************************************************************************/
// uchar	StsChgTerm(enum MSTS_ID MSts, uchar ucParam, uchar ucPnum)
// {
// 										/* MSts		:メイン状態				*/
// 										/* ucParam	:パラメータ				*/
// 										/* ucPnum	:個人番号				*/

// //err01 chg start
// //	if(SYS.INF.ucAREA >= AREA_MAX)		/* 地域未設定の場合					*/
// 	MTR.ucLASTPNUM = ucPnum;			/* 押された個人番号を退避			*/

// 	if(SYS.INF.ucCALBWT != CALBWT_SET)
// 	{									/* 未調整の場合						*/
// 		MSts = MSTS_NTC;				/* メイン状態＝通知状態				*/
// 		SYS.INF.cERRNO = ERR_3;			/* エラー番号設定＝未調整			*/
// 	}
// 	else if((SYS.INF.cERRNO == ERR_7) || (SYS.INF.cERRNO == ERR_VOICE))
// 	{
// 		MSts = MSTS_NTC;				/* メイン状態＝通知状態				*/
// 	}
// 	else if(SYS.INF.ucAREA >= AREA_MAX)	/* 地域未設定の場合					*/
// //err01 chg end
// 	{
// 		ucParam = PARAM_SET_AREA_TIME;	/* パラメータ＝地域＆時計設定		*/
// 		MSts = MSTS_SETUP;				/* メイン状態＝初期設定				*/
// 	}
// 	else if(GetClock(&TIME.CLOCK) == NG)/* 日付時刻未設定の場合				*/
// 	{
// 		ucParam = PARAM_SET_TIME;		/* パラメータ＝時計設定				*/
// 		MSts = MSTS_SETUP;				/* メイン状態＝初期設定				*/
// 	}

// 	if(MTR.MSTS != MSts)				/* メイン状態が変化する場合			*/
// 	{
// //setup01 chg start
// //		StsChgClr(MSts, RAM_INIT, ucParam, ucPnum);
// //										/* 状態遷移＆ＲＡＭ初期化			*/
// 		if(MSts == MSTS_SETUP)
// 		{
// //err01 chg start
// ////			StsChgErr(ERR_PNUM);		/* エラー状態遷移					*/
// 			SYS.INF.ucERRINF = (uchar)((ucParam == PARAM_SET_TIME)
// 								? BLE_ERR_TIME_NONE : BLE_ERR_PNUM_NONE);
// 										/* エラー情報						*/
// 			SetDateDef(&SYS.INF.ERRINF);/* デフォルト日時設定				*/
// 			if(ReqWrite(MEM_KIND_USERINF, (uchar)0) == NG)
// 			{							/* 書込異常の場合					*/
// 				StsChgErr(ERR_MEM);		/* エラー状態遷移					*/
// 			}
// 			else
// 			{
// 				StsChgErr(ERR_SETUP);	/* エラー状態遷移					*/
// 			}
// //err01 chg end
// 		}
// //err01 add start
// 		else if(MSts == MSTS_NTC)
// 		{
// 			StsChgErr(SYS.INF.cERRNO);	/* エラー状態遷移					*/
// 		}
// //err01 add end
// 		else
// 		{
// //err01 add start
// 			if(SYS.INF.ucERRINF != BLE_STS_OK)
// 			{
// 				SYS.INF.ucERRINF = BLE_STS_OK;
// 										/* エラー情報（正常）				*/
// 				s_memcpy(&SYS.INF.ERRINF, &TIME.CLOCK,
// 											sizeof(SYS.INF.ERRINF));
// 										/* 現時刻							*/
// 				if(ReqWrite(MEM_KIND_USERINF, (uchar)0) == NG)
// 				{						/* 書込異常の場合					*/
// 					StsChgErr(ERR_MEM);	/* エラー状態遷移					*/
// 					return(YES);		/* 変化あり返却						*/

// 				}
// 			}
// //err01 add end

// 			StsChgClr(MSts, RAM_INIT, ucParam, ucPnum);
// 										/* 状態遷移＆ＲＡＭ初期化			*/
// 		}
// //setup01 chg end

// 		return(YES);					/* 変化あり返却						*/

// 	}

// 	return(NO);							/* 変化なし返却						*/
// }
// 

// /****************************************************************************/
// /*																			*/
// /*		関数名			：	StsChgClr										*/
// /*																			*/
// /*		関数名称		：	状態遷移＆初期化								*/
// /*																			*/
// /*		作成年月日		：	2009/ 5/14	小山								*/
// /*																			*/
// /*		単体試験履歴	：	2022/  /										*/
// /*																			*/
// /****************************************************************************/
// void	StsChgClr(enum MSTS_ID MSts, uchar ucType, uchar ucParam, uchar ucPnum)
// {
// 										/* MSts		:メイン状態				*/
// 										/* ucType	:初期化種別				*/
// 										/* ucParam	:パラメータ				*/
// 										/* ucPnum	:個人番号				*/

// 	if(ucType == RAM_INIT)				/* 初期化する場合					*/
// 	{
// 		s_memset(&MEAS, (uchar)0, sizeof(MEAS));
// 										/* 測定情報初期化					*/
// 		s_memset(&PSINF, (uchar)0, sizeof(PSINF));
// 										/* 個人情報初期化					*/
// 	}

// 	switch(MSts)
// 	{
// //setup01 del start
// //		case MSTS_SETUP:				/* 初期設定							*/
// //			SYS.INF.ucMODE = MODE_NORMAL;
// //										/* 通常モード						*/
// //			SYS.INF.ucPARAM = ucParam;	/* パラメータ設定					*/
// //			SYS.INF.ucPNUM = PNUM_1;	/* 個人番号1						*/
// //			break;
// //setup01 del end
// //pset01 del start
// //		case MSTS_PSET:					/* 個人設定							*/
// //			SYS.INF.ucMODE = MODE_NORMAL;
// //										/* 通常モード						*/
// //			SYS.INF.ucPARAM = ucParam;	/* パラメータ設定					*/
// //			SYS.INF.ucPNUM = ucPnum;	/* 個人番号設定						*/
// //			break;
// //pset01 del end
// //weit02 del start
// //		case MSTS_WEIT:					/* 体重測定							*/
// //weit02 del end
// 		case MSTS_ISCAN:				/* 体組成測定						*/
// 			SYS.INF.ucMODE = ucParam;	/* 通常orテストモード				*/
// 			SYS.INF.ucPARAM = PARAM_NONE;
// 										/* パラメータなし					*/
// 			SYS.INF.ucPNUM = ucPnum;	/* 個人番号1～5orゲストor体重測定	*/
// 			break;

// //ble01 add start
// 		default:
// 			SYS.INF.ucMODE = ucParam;	/* 通常orテストモード				*/
// 			SYS.INF.ucPARAM = PARAM_NONE;
// 										/* パラメータなし					*/
// 			SYS.INF.ucPNUM = ucPnum;	/* 個人番号1～5orゲストor体重測定	*/
// 			break;
// //ble01 add end
// 	}

// 	StsChg(MSts);						/* 状態遷移(任意)					*/
// /* lcd02 del start															*/
// /*	if(MSts != MSTS_SND)				 * BLEデータ送信以外				*/
// /*	{																		*/
// /*		m_blight();						 * バックライト						*/
// /*	}																		*/
// /* lcd02 del end															*/
// }
// 

// /****************************************************************************/
// /*																			*/
// /*		関数名			：	StsChgErr										*/
// /*																			*/
// /*		関数名称		：	エラー状態遷移									*/
// /*																			*/
// /*		作成年月日		：	2009/ 5/14	小山								*/
// /*																			*/
// /*		単体試験履歴	：	2010/12/13	深田								*/
// /*																			*/
// /****************************************************************************/
// void	StsChgErr(char cErrno)
// {
// 										/* cErrno	:エラー番号				*/

// 	SYS.INF.cERRNO = cErrno;			/* エラー番号設定					*/
// 	StsChg(MSTS_NTC);					/* メイン状態＝通知画面				*/
// }
// 

// /****************************************************************************/
// /*																			*/
// /*		関数名			：	ChkSysinf										*/
// /*																			*/
// /*		関数名称		：	システム情報チェック							*/
// /*																			*/
// /*		作成年月日		：	2010/12/13	深田								*/
// /*																			*/
// /*		単体試験履歴	：	2022/ 7/27	小山								*/
// /*																			*/
// /****************************************************************************/
// void	ChkSysinf(void)
// {
// 	if(SYS.INF.ucSYSID != SYSID_SET)	/* システムＩＤ未書込みの場合		*/
// 	{
// 		s_memcpy(&SYS.BLK, &SYS_INIT.BLK,
// 				(size_t)(sizeof(SYS.BLK.ucSPID) + sizeof(SYS.BLK.ucSPCOEF)));
// 										/* 仕様書込対応領域初期化			*/
// 		SYS.INF.SAVE_UNIT = UNIT_DEF;	/* ユーザー領域初期化				*/
// 	}

// 	if(SYS.INF.ucCALBWT != CALBWT_SET)	/* 器差調整未完了の場合				*/
// 	{
// 		SetSpid(&SYS_INIT.BLK);			/* 仕様書込対応領域初期化			*/
// 										/* ※ラインでの操作を同じにする為	*/
// 										/*  (器差調整時にFR200Lから始まる）	*/
// 		s_memcpy(SYS.BLK.ucCSCL, SYS_INIT.BLK.ucCSCL, sizeof(SYS.BLK.ucCSCL));
// 										/* 器差調整時初期化領域初期化		*/
// 	}

// 	if(GetChkSum((uchar *)&SYS.INF.IMPCALB, (uchar)sizeof(SYS.INF.IMPCALB))
// 			!= SYS.INF.ucIMPCHKSUM)
// 	{									/* チェックサム異常の場合			*/
// 		InitImpConv();					/* インピ補正係数初期化				*/
// 	}

// 	ChkGrav();							/* 重力加速度チェック				*/
// 	ChkCountry();						/* 向け先チェック					*/
// /* step01 del start															*/
// /*	ChkStpon();							 * ステップON閾値チェック			*/
// /* step01 del end															*/
// 	ChkImpConv();						/* インピ変換係数チェック			*/
// 	ChkTemp();							/* 温度補正値チェック				*/
// 	ChkZeroPort();						/* 0点ポートチェック				*/
// 	ChkArea();							/* 地域チェック						*/
// 	ChkUnit();							/* 単位チェック						*/
// //t025 add start
// 	ChkModel();							/* モデル名チェック					*/
// //t025 add end

// /* key01 add start															*/
// 	m_get_ssw();						/* スライドSW読出(音声・ブザー音量)	*/
// /* key01 add end															*/
// }
// 

// /****************************************************************************/
// /*																			*/
// /*		関数名			：	SetSpid											*/
// /*																			*/
// /*		関数名称		：	仕様書込対応領域設定							*/
// /*																			*/
// /*		作成年月日		：	2018/12/ 5	小山								*/
// /*																			*/
// /*		単体試験履歴	：	2019/ 1/11	小山								*/
// /*																			*/
// /****************************************************************************/
// void	SetSpid(const void *pIn)
// {
// 										/* 入力データへのポインタ			*/

// 	ushort	usGrav;						/* 調整地重力加速度					*/
// 	uchar	ucSysid;					/* システムID						*/
// 	uchar	ucStpon;					/* ステップON閾値					*/

// 	usGrav = SYS.INF.usGRAV;			/* 調整地重力加速度退避				*/
// 	ucSysid = SYS.INF.ucSYSID;			/* システムID退避					*/
// 	ucStpon = SYS.INF.ucSTPON;			/* ステップON閾値退避				*/

// 	s_memcpy(&SYS.BLK, pIn, sizeof(SYS.BLK.ucSPID));
// 										/* 仕様書込対応領域設定				*/

// 	SYS.INF.usGRAV = usGrav;			/* 調整地重力加速度復帰				*/
// 	SYS.INF.ucSYSID = ucSysid;			/* システムID復帰					*/
// 	SYS.INF.ucSTPON = ucStpon;			/* ステップON閾値復帰				*/
// }
// 

// /****************************************************************************/
// /*																			*/
// /*		関数名			：	ChkGrav											*/
// /*																			*/
// /*		関数名称		：	重力加速度チェック								*/
// /*																			*/
// /*		作成年月日		：	2010/12/13	深田								*/
// /*																			*/
// /*		単体試験履歴	：	2018/12/ 6	小山								*/
// /*																			*/
// /****************************************************************************/
// void	ChkGrav(void)
// {
// 	if((SYS.INF.usGRAV < GRAV_MIN) || (SYS.INF.usGRAV > GRAV_MAX))
// 	{
// 		SYS.INF.usGRAV = GRAV_DEF;
// 	}
// }
// 

// /****************************************************************************/
// /*																			*/
// /*		関数名			：	ChkCountry										*/
// /*																			*/
// /*		関数名称		：	向け先チェック									*/
// /*																			*/
// /*		作成年月日		：	2010/12/13	深田								*/
// /*																			*/
// /*		単体試験履歴	：	2013/ 3/28	小山								*/
// /*																			*/
// /****************************************************************************/
// void	ChkCountry(void)
// {
// 	if(SYS.INF.COUNTRY >= COUNTRY_MAX)
// 	{									/* 範囲外の場合						*/
// 		SYS.INF.COUNTRY = COUNTRY_DEF;
// 	}
// }
// 

// /* step01 del start															*/
// /****************************************************************************/
// /*																			*/
// /*		関数名			：	ChkStpon										*/
// /*																			*/
// /*		関数名称		：	ステップON閾値チェック							*/
// /*																			*/
// /*		作成年月日		：	2010/12/13	深田								*/
// /*																			*/
// /*		単体試験履歴	：	2010/12/14	深田								*/
// /*																			*/
// /****************************************************************************/
// /*void	ChkStpon(void)														*/
// /*{																			*/
// /*	if((SYS.INF.ucSTPON < (uchar)STPON_MIN)									*/
// /*			|| (SYS.INF.ucSTPON > (uchar)STPON_MAX))						*/
// /*	{																		*/
// /*		SYS.INF.ucSTPON = (uchar)STPON_DEF;									*/
// /*	}																		*/
// /*}																			*/
// /*																			*/
// /* step01 del end															*/

// /****************************************************************************/
// /*																			*/
// /*		関数名			：	ChkImpConv										*/
// /*																			*/
// /*		関数名称		：	インピ変換係数チェック							*/
// /*																			*/
// /*		作成年月日		：	2010/12/13	深田								*/
// /*																			*/
// /*		単体試験履歴	：	2019/12/24	小山								*/
// /*																			*/
// /****************************************************************************/
// void	ChkImpConv(void)
// {
// 	if((SYS.INF.IMPCONV.usCOEFA < IMPCOEF_CR_MIN)
// 		|| (SYS.INF.IMPCONV.usCOEFA > IMPCOEF_CR_MAX)
// 		|| (SYS.INF.IMPCONV.sCOEFB < IMPCOEF_CX_MIN)
// 		|| (SYS.INF.IMPCONV.sCOEFB > IMPCOEF_CX_MAX))
// 	{
// 		SYS.INF.IMPCONV.usCOEFA = IMPCOEF_CR_DEF;
// 		SYS.INF.IMPCONV.sCOEFB = IMPCOEF_CX_DEF;
// 	}

// /* imp01 add start															*/
// 	if((SYS.INF.IMPCONV_5.usCOEFA < IMPCOEF_CR_MIN)
// 		|| (SYS.INF.IMPCONV_5.usCOEFA > IMPCOEF_CR_MAX)
// 		|| (SYS.INF.IMPCONV_5.sCOEFB < IMPCOEF_CX_MIN)
// 		|| (SYS.INF.IMPCONV_5.sCOEFB > IMPCOEF_CX_MAX))
// 	{
// 		SYS.INF.IMPCONV_5.usCOEFA = IMPCOEF_CR_DEF_5;
// 		SYS.INF.IMPCONV_5.sCOEFB = IMPCOEF_CX_DEF_5;
// 	}
// /* imp01 add end															*/

// }
// 

// /****************************************************************************/
// /*																			*/
// /*		関数名			：	ChkTemp											*/
// /*																			*/
// /*		関数名称		：	温度補正値チェック								*/
// /*																			*/
// /*		作成年月日		：	2010/12/13	深田								*/
// /*																			*/
// /*		単体試験履歴	：	2010/12/14	深田								*/
// /*																			*/
// /****************************************************************************/
// void	ChkTemp(void)
// {
// 	if((SYS.INF.sTEMPCOEF < TEMPCOEF_MIN)
// 			|| (SYS.INF.sTEMPCOEF > TEMPCOEF_MAX))
// 	{
// 		SYS.INF.sTEMPCOEF = TEMPCOEF_DEF;
// 	}
// }
// 

// /****************************************************************************/
// /*																			*/
// /*		関数名			：	ChkZeroPort										*/
// /*																			*/
// /*		関数名称		：	0点ポートチェック								*/
// /*																			*/
// /*		作成年月日		：	2010/12/13	深田								*/
// /*																			*/
// /*		単体試験履歴	：	2010/12/14	深田								*/
// /*																			*/
// /****************************************************************************/
// void	ChkZeroPort(void)
// {
// 	if(SYS.INF.ucZEROP > ZEROP_MAX)
// 	{
// 		SYS.INF.ucZEROP = (uchar)0;
// 	}
// }
// 

// /****************************************************************************/
// /*																			*/
// /*		関数名			：	ChkArea											*/
// /*																			*/
// /*		関数名称		：	地域チェック									*/
// /*																			*/
// /*		作成年月日		：	2010/12/13	深田								*/
// /*																			*/
// /*		単体試験履歴	：	2018/12/ 6	小山								*/
// /*																			*/
// /****************************************************************************/
// void	ChkArea(void)
// {
// 	if((SYS.INF.ucAREA >= AREA_MAX) || (SYS.INF.ucCALBWT != CALBWT_SET))
// 										/* 範囲外、又は器差調整未完了の場合	*/
// 	{
// 		SYS.INF.ucAREA = AREA_INIT;
// 	}
// }
// 

// /****************************************************************************/
// /*																			*/
// /*		関数名			：	ChkUnit											*/
// /*																			*/
// /*		関数名称		：	単位チェック									*/
// /*																			*/
// /*		作成年月日		：	2010/12/13	深田								*/
// /*																			*/
// /*		単体試験履歴	：	2013/ 3/28	小山								*/
// /*																			*/
// /****************************************************************************/
// void	ChkUnit(void)
// {
// 	if(SYS.INF.SAVE_UNIT >= UNIT_MAX)
// 	{
// 		SYS.INF.SAVE_UNIT = UNIT_DEF;
// 	}
// 	SYS.INF.UNIT = SYS.INF.SAVE_UNIT;	/* 単位切替設定						*/
// }
// 

// /****************************************************************************/
// /*																			*/
// /*		関数名			：	GetArea											*/
// /*																			*/
// /*		関数名称		：	地域取得										*/
// /*																			*/
// /*		作成年月日		：	2016/ 8/ 8	小山								*/
// /*																			*/
// /*		単体試験履歴	：	2019/ 1/11	小山								*/
// /*																			*/
// /****************************************************************************/
// uchar	GetArea(void)
// {
// 	uchar	ucArea;						/* 地域								*/

// 	if(SYS.INF.COUNTRY == COUNTRY_JP)
// 	{									/* 国内の場合						*/
// 		ucArea = (uchar)((SYS.INF.ucAREA >= AREA_MAX_JP)
// 							? AREA_DEF : SYS.INF.ucAREA);
// 										/* 地域初期値設定					*/
// 	}
// 	else								/* 海外の場合						*/
// 	{
// 		ucArea = (uchar)((SYS.INF.ucAREA >= AREA_MAX)
// 							? SYS.INF.ucGRAV_TO : SYS.INF.ucAREA);
// 										/* 地域初期値設定					*/
// 	}
// 	return(ucArea);						/* 地域返却							*/
// }
// 

// //t025 add start
// /****************************************************************************/
// /*																			*/
// /*		関数名			：	ChkModel										*/
// /*																			*/
// /*		関数名称		：	モデル名チェック								*/
// /*																			*/
// /*		作成年月日		：	2022/ 9/ 7	小山								*/
// /*																			*/
// /*		単体試験履歴	：	2022/  /										*/
// /*																			*/
// /****************************************************************************/
// void	ChkModel(void)
// {
// 	if(ChkAscCode(SYS.INF.cMODEL, BLE_NAME_SIZE) == NG)
// 	{									/* モデル名異常の場合				*/
// 		s_memcpy(&SYS.INF.cMODEL, (char*)Str_DName_Fr200l,
// 											(size_t)BLE_NAME_SIZE);
// 										/* Device Name デフォルト設定		*/
// 	}
// }
// 
// //t025 add end

// /****************************************************************************/
// /*																			*/
// /*		関数名			：	ChkAscCode										*/
// /*																			*/
// /*		関数名称		：	アスキーコードチェック							*/
// /*																			*/
// /*		作成年月日		：	2012/ 2/23	小山								*/
// /*																			*/
// /*		単体試験履歴	：	2014/ 2/10	小山								*/
// /*																			*/
// /****************************************************************************/
// uchar	ChkAscCode(char *pAsc, uchar ucLen)
// {
// 										/* pAsc	：アスキーコードポインタ	*/
// 										/* ucLen：データ長					*/

// 	uchar	ucCnt;						/* ローカルカウンタ					*/
// 	char	cAsc;						/* アスキーコード					*/

// 	for(ucCnt = (uchar)0; ucCnt < ucLen; ucCnt++, pAsc++)
// 	{
// 		cAsc = *pAsc;
// 		if(cAsc
// 			&& (cAsc != ' ')
// 			&& (cAsc != '-')
// 			&& (cAsc != '_')
// 			&& (('0' > cAsc) || (cAsc > '9'))
// 			&& (('A' > cAsc) || (cAsc > 'Z'))
// 			&& (('a' > cAsc) || (cAsc > 'z')))
// 										/* NULL(0)、半角英数字、SP、-、_、	*/
// 		{								/* 以外の場合						*/
// 			return(NG);
// 		}
// 	}
// 	return(OK);
// }
// 

// /****************************************************************************/
// /*																			*/
// /*		関数名			：	ChkPsinf										*/
// /*																			*/
// /*		関数名称		：	個人情報チェック								*/
// /*																			*/
// /*		作成年月日		：	2009/ 5/14	小山								*/
// /*																			*/
// /*		単体試験履歴	：	2022/  /										*/
// /*																			*/
// /****************************************************************************/
// void	ChkPsinf(void)
// {
// 	if(ChkPsId(PSID_SETMIDL_AGE) == NG)	/* 個人ＩＤ異常の場合				*/
// 	{
// 		SetPsinfDef(PSID_INIT);			/* 個人情報デフォルト設定			*/
// 	}
// 	else								/* 個人ＩＤ正常（生年済み）の場合	*/
// 	{
// 		PSINF.ucFIG &= (uchar)(SYS.INF.SPECB.BIT.ATHLE
// 												? FIG_MASK : SEX_MASK);
// 										/* 性別/体型をガード				*/
// 		PSINF.usHEIT = RoundHt(PSINF.usHEIT);
// 										/* 身長丸め（チェック含む）			*/
// 										/* ※単位切替の端数なくすため丸める	*/
// 		DecodeDate(&PSINF.DOB, PSINF.usDOB);
// 										/* 年月日解凍						*/
// 		SetPsAgeLimit(&PSINF.DOB, &PSINF.ucFIG, &PSINF.AL, AGE_MAX);
// 										/* 個人情報年齢制限設定(表示用)		*/
// 		if(ChkAl(PSINF.AL, PSINF.ucFIG, PSINF.ucAGE) == NG)
// 		{								/* 生活強度が異常の場合				*/
// 			PSINF.AL = GetAlDef(PSINF.ucFIG);
// 										/* 生活強度デフォルト				*/
// 		}

// 		if(PSINF.CLOCK.usDATE > TIME.CLOCK.usDATE)
// 		{								/* 登録年月日が未来の場合			*/
// //err01 chg start
// //			s_memset(&PSINF.CLOCK, (uchar)0, sizeof(PSINF.CLOCK));
// //										/* 登録年月日時分秒クリア			*/
// //			PSINF.CLOCK.usDATE = DATE_DEF;
// //										/* 圧縮年月日デフォルト値設定		*/
// 			SetDateDef(&PSINF.CLOCK);	/* デフォルト日時設定				*/
// //err01 chg end
// 		}

// 		if(ChkAge(PSINF.ucAGE) == NG)
// 		{								/* 最小年齢未満の場合				*/
// 			PSINF.ucPLSMEAS = OFF;		/* 脈拍測定を無効にする				*/
// 		}
// 	}
// }
// 

// //pset01 del start
// /****************************************************************************/
// /*																			*/
// /*		関数名			：	ChkPsinfChg										*/
// /*																			*/
// /*		関数名称		：	個人情報変更チェック							*/
// /*																			*/
// /*		作成年月日		：	2009/ 5/14	小山								*/
// /*																			*/
// /*		単体試験履歴	：	2020/ 7/30	野﨑								*/
// /*																			*/
// /****************************************************************************/
// //void	ChkPsinfChg(void)
// //{
// //	if(ChkPsId(PSID_SETMIDL_AGE) == OK)	/* ID有り（生年済み）の場合			*/
// //	{									/* ※誕生日,性別が変更された場合に	*/
// //										/*   必要なパラメータをデフォルトに	*/
// //										/*   戻す							*/
// //		switch(MTR.SSTS)
// //		{
// //			case SSTS_PSET_DAY:			/* 日状態							*/
// //				if((FUNC.PSET.ucCLR == YES)
// //					|| (FUNC.PSET.usDOB != PSINF.usDOB))
// //				{						/* 誕生日に変更があった場合			*/
// //					FUNC.PSET.ucCLR = YES;
// //										/* 変更状態＝変更有り				*/
// //					FUNC.PSET.ucFIG = FIG_DEF;
// //										/* 性別/体型デフォルト設定			*/
// //				}
// //										/* break不要						*/
// //
// //			case SSTS_PSET_SEX:			/* 性別状態							*/
// //				if((FUNC.PSET.ucCLR == YES)
// //					|| ((uchar)(FUNC.PSET.ucFIG & SEX_MASK)
// //						!= (uchar)(PSINF.ucFIG & SEX_MASK)))
// //										/* 性別に変更があった場合			*/
// //				{						/* ※体型変更は同一人物とする		*/
// //					FUNC.PSET.ucCLR = YES;
// //										/* 変更状態＝変更有り				*/
// //					FUNC.PSET.usHEIT = GetHtDef(SYS.INF.UNIT);
// //										/* 身長デフォルト					*/
// //					FUNC.PSET.AL = GetAlDef(FUNC.PSET.ucFIG);
// //										/* 生活強度デフォルト				*/
// //					FUNC.PSET.ucSNS = SNS_DEF;
// //										/* SNS設定デフォルト				*/
// //					FUNC.PSET.ucPLSMEAS = PLSMEAS_DEF;
// //										/* 脈拍測定情報デフォルト			*/
// //				}
// //				break;
// //		}
// //	}
// //}
// //
// //pset01 del end

// /****************************************************************************/
// /*																			*/
// /*		関数名			：	ChkPsDat										*/
// /*																			*/
// /*		関数名称		：	測定データチェック								*/
// /*																			*/
// /*		作成年月日		：	2010/ 9/30	深田								*/
// /*																			*/
// /*		単体試験履歴	：	2022/  /										*/
// /*																			*/
// /****************************************************************************/
// uchar	ChkPsDat(struct PSMEM_DAT_T *pPs)
// {
// 	uchar	ucRet;						/* 戻り値							*/

// 	ucRet = OK;							/* 戻り値初期化						*/

// 	if(pPs->CLOCK.usDATE < DATE_DEF)	/* 測定日							*/
// 	{
// 		pPs->CLOCK.usDATE = DATE_DEF;
// 		ucRet = NG;
// 	}

// 	pPs->usHEIT = ChkHt(pPs->usHEIT);	/* 身長								*/

// 	if(pPs->ucFIG > FIG_MASK)			/* 性別/体型						*/
// 	{
// 		pPs->ucFIG = (uchar)FIG_DEF;
// 	}

// 	if((uchar)pPs->AL >= (uchar)AL_MAX)	/* 生活強度							*/
// 	{
// 		pPs->AL = GetAlDef(pPs->ucFIG);
// 	}

// 										/* 年齢チェック無し					*/

// 	if(ChkWt(pPs->REV.usWEIT) == NG)	/* 体重								*/
// 	{
// 		pPs->REV.usWEIT = (ushort)0;
// 		ucRet = NG;
// 	}
// //err01 del start
// //										/* 回帰式データチェック無し			*/
// //										/* 温度データチェック無し			*/
// //										/* 秤０点データチェック無し			*/
// //	if(pPs->sR50 == (short)0)			/* レジスタンス（50kHz）			*/
// //	{									/* リアクタンスはチェック無し		*/
// //		ucRet = NG;
// //	}
// //										/* 5kHzはチェック無し				*/
// //err01 del end
// 	return(ucRet);						/* 戻り値返却						*/
// }
// 

// /****************************************************************************/
// /*																			*/
// /*		関数名			：	ChkPs											*/
// /*																			*/
// /*		関数名称		：	個人情報簡易チェック							*/
// /*																			*/
// /*		作成年月日		：	2010/10/22	深田								*/
// /*																			*/
// /*		単体試験履歴	：	2014/  /										*/
// /*																			*/
// /****************************************************************************/
// uchar	ChkPs(void)
// {
// 	if(ChkPsId(PSID_SETMIDL_AL) == NG)	/* ＩＤ異常の場合はＮＧ返却			*/
// 	{
// 		return(NG);
// 	}
// 	return(OK);							/* その他の場合はＯＫ返却			*/
// }
// 

// /****************************************************************************/
// /*																			*/
// /*		関数名			：	ChkPsId											*/
// /*																			*/
// /*		関数名称		：	個人ＩＤチェック								*/
// /*																			*/
// /*		作成年月日		：	2013/ 3/19	小山								*/
// /*																			*/
// /*		単体試験履歴	：	2013/ 3/25	小山								*/
// /*																			*/
// /****************************************************************************/
// uchar	ChkPsId(uchar ucId)
// {
// 										/* ucId		:有効ＩＤ				*/
// 	if((ucId <= PSINF.ucID) && (PSINF.ucID <= PSID_SET))
// 	{									/* ＩＤありはＯＫ返却				*/
// 		return(OK);
// 	}
// 	return(NG);							/* その他の場合はＮＧ返却			*/
// }
// 

// /****************************************************************************/
// /*																			*/
// /*		関数名			：	ChkAge											*/
// /*																			*/
// /*		関数名称		：	年齢チェック									*/
// /*																			*/
// /*		作成年月日		：	2009/ 6/ 2	深田								*/
// /*																			*/
// /*		単体試験履歴	：	2014/  /										*/
// /*																			*/
// /****************************************************************************/
// uchar	ChkAge(uchar ucAge)
// {
// 										/* ucAge	:年齢					*/

// 	if((ucAge < GetAgeMin()) || (AGE_MAX_ISCAN < ucAge))
// 	{
// 		return(NG);
// 	}
// 	return(OK);
// }
// 

// /****************************************************************************/
// /*																			*/
// /*		関数名			：	GetAgeMin										*/
// /*																			*/
// /*		関数名称		：	年齢最小値取得									*/
// /*																			*/
// /*		作成年月日		：	2009/ 6/ 2	深田								*/
// /*																			*/
// /*		単体試験履歴	：	2013/ 3/28	小山								*/
// /*																			*/
// /****************************************************************************/
// uchar	GetAgeMin(void)
// {
// 	if(SYS.INF.SPECB.BIT.AGE7)			/* 最小年齢７才仕様の場合			*/
// 	{
// 		return(AGE_MIN_AGE7);
// 	}
// 	return(AgeMin_Tbl[SYS.INF.COUNTRY]);
// }
// 

// /****************************************************************************/
// /*																			*/
// /*		関数名			：	GetAgeMinMslBone								*/
// /*																			*/
// /*		関数名称		：	筋肉量/骨量年齢最小値取得						*/
// /*																			*/
// /*		作成年月日		：	2010/ 8/12	深田								*/
// /*																			*/
// /*		単体試験履歴	：	2010/12/14	深田								*/
// /*																			*/
// /****************************************************************************/
// uchar	GetAgeMinMslBone(void)
// {
// 	return(AgeMinMslBone_Tbl[SYS.INF.COUNTRY]);
// }
// 

// /****************************************************************************/
// /*																			*/
// /*		関数名			：	ChkAgeAdult										*/
// /*																			*/
// /*		関数名称		：	成年チェック									*/
// /*																			*/
// /*		作成年月日		：	2009/ 6/ 2	深田								*/
// /*																			*/
// /*		単体試験履歴	：	2010/12/14	深田								*/
// /*																			*/
// /****************************************************************************/
// uchar	ChkAgeAdult(uchar ucAge)
// {
// 										/* ucAge	:年齢					*/
// 	if(ucAge < AGE_ADLT)
// 	{
// 		return(NG);
// 	}
// 	return(OK);
// }
// 

// /****************************************************************************/
// /*																			*/
// /*		関数名			：	GetHtNotch										*/
// /*																			*/
// /*		関数名称		：	身長目量取得									*/
// /*																			*/
// /*		作成年月日		：	2010/ 8/19	深田								*/
// /*																			*/
// /*		単体試験履歴	：	2010/12/14	深田								*/
// /*																			*/
// /****************************************************************************/
// uchar	GetHtNotch(enum COUNTRY_ID Country)
// {
// 										/* Country	:向け先					*/
// 	return((uchar)((Country == COUNTRY_JP) ? OFF : ON));
// 										/* 身長目量 0.5cm,or,1cm			*/
// }
// 

// /****************************************************************************/
// /*																			*/
// /*		関数名			：	ChkHt											*/
// /*																			*/
// /*		関数名称		：	身長チェック									*/
// /*																			*/
// /*		作成年月日		：	2012/ 5/16	小山								*/
// /*																			*/
// /*		単体試験履歴	：	2013/ 3/28	小山								*/
// /*																			*/
// /****************************************************************************/
// ushort	ChkHt(ushort usHt)
// {
// 										/* usHt		:身長					*/

// 	ushort	usMax;						/* 最大								*/
// 	ushort	usMin;						/* 最小								*/

// 	usMax = GetHtMax(UNIT_LB);			/* 最大値取得						*/
// 	usMin = GetHtMin(UNIT_KG);			/* 最小値取得						*/

// 	if(usHt < usMin)
// 	{
// 		usHt = usMin;
// 	}
// 	else if(usHt > usMax)
// 	{
// 		usHt = usMax;
// 	}
// 	return(usHt);						/* 身長返却							*/
// }
// 

// /****************************************************************************/
// /*																			*/
// /*		関数名			：	GetHtMin										*/
// /*																			*/
// /*		関数名称		：	身長最小値取得									*/
// /*																			*/
// /*		作成年月日		：	2012/ 5/16	小山								*/
// /*																			*/
// /*		単体試験履歴	：	2013/ 3/28	小山								*/
// /*																			*/
// /****************************************************************************/
// ushort	GetHtMin(enum UNIT_ID Unit)
// {
// 										/* Unit:	単位					*/

// 	if(SYS.INF.SPECB.BIT.AGE7)			/* 最小年齢７才仕様の場合			*/
// 	{
// 		return((Unit == UNIT_KG) ? HEIT_CM_MIN_US : HEIT_FI_MIN_US);
// 	}
// 	else								/* 最小年齢５才仕様の場合			*/
// 	{
// 		return((Unit == UNIT_KG) ? HEIT_CM_MIN : HEIT_FI_MIN);
// 	}
// }
// 

// /****************************************************************************/
// /*																			*/
// /*		関数名			：	GetHtMax										*/
// /*																			*/
// /*		関数名称		：	身長最大値取得									*/
// /*																			*/
// /*		作成年月日		：	2012/ 5/16	小山								*/
// /*																			*/
// /*		単体試験履歴	：	2013/ 3/28	小山								*/
// /*																			*/
// /****************************************************************************/
// ushort	GetHtMax(enum UNIT_ID Unit)
// {
// 										/* Unit:	単位					*/
// 										/* 身長最大値は単位に依存する		*/
// 	return((Unit == UNIT_KG) ? HEIT_CM_MAX : HEIT_FI_MAX);
// 										/* ※テーブル参照にするとＲＯＭ浪費	*/
// }
// 

// /****************************************************************************/
// /*																			*/
// /*		関数名			：	GetHtDef										*/
// /*																			*/
// /*		関数名称		：	身長デフォルト取得								*/
// /*																			*/
// /*		作成年月日		：	2012/ 5/16	小山								*/
// /*																			*/
// /*		単体試験履歴	：	2013/ 3/28	小山								*/
// /*																			*/
// /****************************************************************************/
// ushort	GetHtDef(enum UNIT_ID Unit)
// {
// 										/* Unit:	単位					*/

// 	return((Unit == UNIT_KG) ? ((SYS.INF.COUNTRY == COUNTRY_JP)
// 				? HEIT_CM_DEF_JP : HEIT_CM_DEF) : HEIT_FI_DEF);
// 										/* ※テーブル参照にするとＲＯＭ浪費	*/
// }
// 

// //spec01 del start
// /****************************************************************************/
// /*																			*/
// /*		関数名			：	ChkAlEnable										*/
// /*																			*/
// /*		関数名称		：	生活強度有効チェック							*/
// /*																			*/
// /*		作成年月日		：	2010/ 8/ 4	小山								*/
// /*																			*/
// /*		単体試験履歴	：	2012/  /										*/
// /*																			*/
// /****************************************************************************/
// //uchar	ChkAlEnable(uchar ucFig, uchar ucAge)
// //{
// //										/* ucFig	:体型					*/
// //										/* ucAge	:年齢					*/
// //
// //	if(!SYS.INF.SPECEX.BIT.BMR
// //		|| !SYS.INF.SPECEX.BIT.DCI
// //		|| (ucFig & AT_MASK)
// //		|| (ChkAgeAdult(ucAge) == NG))
// //										/* ＢＭＲ無し仕様又はＢＭＲ選択又は	*/
// //	{									/* アスリート又は成人以外の場合		*/
// //		return(NG);						/* 生活強度無効						*/
// //	}
// //	return(OK);							/* その他の場合は有効				*/
// //}
// //
// //spec01 del end

// /****************************************************************************/
// /*																			*/
// /*		関数名			：	ChkAl											*/
// /*																			*/
// /*		関数名称		：	生活強度チェック								*/
// /*																			*/
// /*		作成年月日		：	2010/ 8/ 4	小山								*/
// /*																			*/
// /*		単体試験履歴	：	2013/ 3/28	小山								*/
// /*																			*/
// /****************************************************************************/
// uchar	ChkAl(enum AL_ID Al, uchar ucFig, uchar ucAge)
// {
// 										/* Al		:生活強度				*/
// 										/* ucFig	:体型					*/
// 										/* ucAge	:年齢					*/
// 	if(((uchar)Al >= (uchar)AL_MAX)
// 		|| ((ucFig & AT_MASK) && (Al != AL_ATH))
// 		|| ((ChkAgeAdult(ucAge) == NG) && (Al != AL_DEF)))
// 	{									/* 生活強度範囲チェック				*/
// 		return(NG);
// 	}
// 	return(OK);
// }
// 

// /****************************************************************************/
// /*																			*/
// /*		関数名			：	GetAlDef										*/
// /*																			*/
// /*		関数名称		：	生活強度デフォルト取得							*/
// /*																			*/
// /*		作成年月日		：	2010/ 8/ 4	小山								*/
// /*																			*/
// /*		単体試験履歴	：	2010/10/19	小山								*/
// /*																			*/
// /****************************************************************************/
// enum AL_ID	GetAlDef(uchar ucFig)
// {
// 										/* ucFig:	体型					*/
// 	return((ucFig & AT_MASK) ? AL_ATH : AL_DEF);
// }
// 

// /****************************************************************************/
// /*																			*/
// /*		関数名			：	ChkWt											*/
// /*																			*/
// /*		関数名称		：	体重チェック									*/
// /*																			*/
// /*		作成年月日		：	2009/ 6/ 2	深田								*/
// /*																			*/
// /*		単体試験履歴	：	2010/12/14	深田								*/
// /*																			*/
// /****************************************************************************/
// uchar	ChkWt(ushort usWt)
// {
// 										/* usWt	:体重						*/
// 	if((usWt < WEIT_MIN) || (usWt > GetWtMax()))
// 	{
// 		return(NG);
// 	}

// 	return(OK);
// }
// 

// /****************************************************************************/
// /*																			*/
// /*		関数名			：	GetWtMax										*/
// /*																			*/
// /*		関数名称		：	体重最大値取得									*/
// /*																			*/
// /*		作成年月日		：	2009/ 5/14	小山								*/
// /*																			*/
// /*		単体試験履歴	：	2010/12/14	深田								*/
// /*																			*/
// /****************************************************************************/
// ushort	GetWtMax(void)
// {
// 	return(WtMaxChk_Tbl[SYS.INF.SPECB.BIT.WT_200KG][SYS.INF.SPECB.BIT.WT_100G + SYS.INF.SPECB.BIT.WT_DUAL]);
// }
// 

// /****************************************************************************/
// /*																			*/
// /*		関数名			：	SetPsAgeLimit									*/
// /*																			*/
// /*		関数名称		：	個人情報年齢制限設定							*/
// /*																			*/
// /*		作成年月日		：	2009/ 5/14	小山								*/
// /*																			*/
// /*		単体試験履歴	：	2010/12/14	深田								*/
// /*																			*/
// /****************************************************************************/
// void	SetPsAgeLimit(struct YMD_T *pDob, uchar *pFig,
// 										enum AL_ID *pAl, uchar ucAgeMax)
// {
// 										/* pDob		:誕生日へのポインタ		*/
// 										/* pFig		:体型へのポインタ		*/
// 										/* pAl		:生活強度へのポインタ	*/
// 										/* ucAgeMax	:最大年齢				*/

// 	if(SYS.INF.ucPNUM < PNUM_GUEST)
// 	{									/* ゲストモード以外の場合			*/
// 		PSINF.ucAGE = GetAge(pDob, &TIME.DATE, ucAgeMax);
// 	}									/* 年齢取得							*/

// 	if(ChkAgeAdult(PSINF.ucAGE) == NG)	/* 成人以外の場合					*/
// 	{
// 		*pFig &= SEX_MASK;				/* 体型設定を無効にする				*/
// 		*pAl = AL_DEF;					/* 生活強度をデフォルトにする		*/
// 	}
// }
// 

// /****************************************************************************/
// /*																			*/
// /*		関数名			：	SetPsinfDef										*/
// /*																			*/
// /*		関数名称		：	個人情報デフォルト設定							*/
// /*																			*/
// /*		作成年月日		：	2009/ 5/14	小山								*/
// /*																			*/
// /*		単体試験履歴	：	2020/ 7/17	野﨑								*/
// /*																			*/
// /****************************************************************************/
// void	SetPsinfDef(uchar ucId)
// {
// 										/* ucId	:ＩＤ						*/

// 	PSINF.ucID = ucId;					/* ＩＤ設定							*/

// 	PSINF.ucFIG = FIG_DEF;				/* 性別/体型設定					*/

// 	PSINF.DOB.usYEAR = (ushort)(TIME.DATE.usYEAR - (ushort)AGE_DEF);
// 	PSINF.DOB.ucMONTH = (uchar)1;		/* 誕生日(年月日)設定				*/
// 	PSINF.DOB.ucDAY = (uchar)1;
// 	EncodeDate(&PSINF.usDOB, &PSINF.DOB);
// 										/* 年月日圧縮						*/
// 	PSINF.ucAGE = AGE_DEF;				/* 年齢設定							*/

// 	SetPsinfInit();						/* 個人情報初期化					*/
// 	PSINF.AL = AL_DEF;					/* 生活強度設定						*/
// 	if(SYS.INF.ucMODE == MODE_TEST)		/* テストモードの場合				*/
// 	{
// 		PSINF.usHEIT = HEIT_CM_TEST;	/* 身長設定							*/
// 	}
// 	else								/* その他の場合						*/
// 	{
// 		PSINF.usHEIT = GetHtDef(SYS.INF.UNIT);
// 										/* 身長デフォルト					*/
// 	}
// 	PSINF.ucSNS = SNS_DEF;				/* SNS設定デフォルト				*/
// 	PSINF.ucPLSMEAS = PLSMEAS_DEF;		/* 脈拍測定情報デフォルト			*/
// }
// 

// /****************************************************************************/
// /*																			*/
// /*		関数名			：	SetPsinfInit									*/
// /*																			*/
// /*		関数名称		：	個人情報初期化									*/
// /*																			*/
// /*		作成年月日		：	2010/ 5/26	深田								*/
// /*																			*/
// /*		単体試験履歴	：	2022/  /										*/
// /*																			*/
// /****************************************************************************/
// void	SetPsinfInit(void)
// {
// 	s_memset(PSINF.ucMNG, PSBLK_INIT, sizeof(PSINF.ucMNG));
// 										/* 管理情報クリア					*/
// 	PSINF.ucPAIR = OFF;					/* ペアリング情報初期化				*/
// 	PSINF.ucNONSND = (uchar)0;			/* 未送信データ数初期化				*/
// 	PSINF.usTARE = (ushort)0;			/* 風袋量初期化						*/
// /* ble01 add start															*/
// 	PSINF.ulMEASCNT = (ulong)0;			/* 測定回数初期化					*/
// /* ble01 add end															*/
// 	s_memset(&PSINF.CLOCK, (uchar)0, sizeof(PSINF.CLOCK));
// 										/* 登録年月日時分秒クリア			*/
// 	s_memset(PSINF.cNAME, (uchar)0, sizeof(PSINF.cNAME));
// 										/* 名前クリア						*/
// 	s_memset(PSINF.cUUID, (uchar)0, sizeof(PSINF.cUUID));
// 										/* ＵＵＩＤクリア					*/
// //t020 add start
// 	s_memset(&PSINF.MQSLAST, (uchar)0, sizeof(PSINF.CLOCK));
// 										/* 前回筋質スコア年月日時分秒クリア	*/
// 	PSINF.ucMQSLAST = MQP_ERR;			/* 前回筋質スコア※初期化は0ではない*/
// //t020 add end
// }
// 

// /****************************************************************************/
// /*																			*/
// /*		関数名			：	SetPsdatInit									*/
// /*																			*/
// /*		関数名称		：	個人測定データ初期化							*/
// /*																			*/
// /*		作成年月日		：	2013/ 3/19	小山								*/
// /*																			*/
// /*		単体試験履歴	：	2022/  /										*/
// /*																			*/
// /****************************************************************************/
// void	SetPsdatInit(void)
// {
// 	s_memset(&PSINF.DAT[ILAST], (uchar)0, sizeof(PSINF.DAT[ILAST]));
// 										/* 前回データ初期化					*/
// 	s_memset(&PSINF.DAT[ITHIS], (uchar)0, sizeof(PSINF.DAT[ITHIS]));
// 										/* 今回データ初期化					*/
// 	s_memset(&PSINF.REV, (uchar)0, sizeof(PSINF.REV));
// 										/* 回帰式データ初期化				*/
// //t020 add start
// 	PSINF.DAT[ILAST].REV.ucMQP = MQP_ERR;/*	筋質点数	※初期化は０ではない*/
// 	PSINF.DAT[ILAST].REV.ucMQS = MQP_ERR;/*	筋質スコア		〃				*/
// 	PSINF.DAT[ITHIS].REV.ucMQP = MQP_ERR;/*	筋質点数	※初期化は０ではない*/
// 	PSINF.DAT[ITHIS].REV.ucMQS = MQP_ERR;/*	筋質スコア		〃				*/
// 	PSINF.REV.ucMQP = MQP_ERR;			/*	筋質点数	※初期化は０ではない*/
// 	PSINF.REV.ucMQS = MQP_ERR;			/*	筋質スコア		〃				*/
// //t020 add end
// }
// 

// //pset01 del start
// /****************************************************************************/
// /*																			*/
// /*		関数名			：	PsinfToPstmp									*/
// /*																			*/
// /*		関数名称		：	個人情報⇒一時領域								*/
// /*																			*/
// /*		作成年月日		：	2009/ 5/14	小山								*/
// /*																			*/
// /*		単体試験履歴	：	2020/ 7/17	野﨑								*/
// /*																			*/
// /****************************************************************************/
// //void	PsinfToPstmp(void)
// //{
// //	FUNC.PSET.ucFIG = PSINF.ucFIG;		/* 性別/体型設定					*/
// //	FUNC.PSET.usDOB = PSINF.usDOB;		/* 誕生日設定						*/
// //	FUNC.PSET.DOB.usYEAR = PSINF.DOB.usYEAR;
// //	FUNC.PSET.DOB.ucMONTH = PSINF.DOB.ucMONTH;
// //	FUNC.PSET.DOB.ucDAY = PSINF.DOB.ucDAY;
// //										/* 誕生日(年月日)設定				*/
// //	FUNC.PSET.usHEIT = PSINF.usHEIT;	/* 身長設定							*/
// //	FUNC.PSET.AL = PSINF.AL;			/* 生活強度設定						*/
// //	FUNC.PSET.ucSNS = PSINF.ucSNS;		/* SNS設定							*/
// //	FUNC.PSET.ucPLSMEAS = PSINF.ucPLSMEAS;
// //										/* 脈拍測定情報						*/
// //}
// //
// //
// /****************************************************************************/
// /*																			*/
// /*		関数名			：	PstmpToPsinf									*/
// /*																			*/
// /*		関数名称		：	一時領域⇒個人情報								*/
// /*																			*/
// /*		作成年月日		：	2009/ 5/14	小山								*/
// /*																			*/
// /*		単体試験履歴	：	2020/ 7/17	野﨑								*/
// /*																			*/
// /****************************************************************************/
// //void	PstmpToPsinf(void)
// //{
// //	PSINF.ucFIG = FUNC.PSET.ucFIG;		/* 性別/体型設定					*/
// //	PSINF.usDOB = FUNC.PSET.usDOB;		/* 誕生日設定						*/
// //	PSINF.usHEIT = FUNC.PSET.usHEIT;	/* 身長設定							*/
// //	PSINF.AL = (enum AL_ID)(
// //				(ChkAl(FUNC.PSET.AL, FUNC.PSET.ucFIG, PSINF.ucAGE) == NG)
// //					? GetAlDef(FUNC.PSET.ucFIG) : FUNC.PSET.AL);
// //										/* 生活強度設定						*/
// //	s_memcpy(&PSINF.DOB, &FUNC.PSET.DOB, sizeof(PSINF.DOB));
// //										/* 誕生日(年月日)設定				*/
// //	PSINF.ucSNS = FUNC.PSET.ucSNS;		/* SNS設定							*/
// //	PSINF.ucPLSMEAS = FUNC.PSET.ucPLSMEAS;
// //										/* 脈拍測定情報						*/
// //	if((PSINF.ucID != PSID_SET) || (FUNC.PSET.ucCLR == YES))
// //	{									/* ID未設定、又は、消去選択の場合	*/
// //		PSINF.ucID = PSID_SET;			/* ID設定							*/
// //		SetPsinfInit();					/* 個人情報初期化					*/
// //	}
// //}
// //
// //pset01 del end
// //key01 del start
// /****************************************************************************/
// /*																			*/
// /*		関数名			：	CountUD											*/
// /*																			*/
// /*		関数名称		：	カウンタ制御									*/
// /*																			*/
// /*		作成年月日		：	2009/ 5/14	小山								*/
// /*																			*/
// /*		単体試験履歴	：	2019/ 1/11	小山								*/
// /*																			*/
// /****************************************************************************/
// //void	CountUD(uchar ucType)
// //{
// //										/* ucType	:カウント種別			*/
// //	uchar	*pByte;						/* 1バイトデータへのポインタ		*/
// //	ushort	*pWord;						/* 2バイトデータへのポインタ		*/
// //	ushort	usMin;						/* 最小値							*/
// //	ushort	usMax;						/* 最大値							*/
// //	ushort	usVal;						/* 値								*/
// //	ushort	usChg;						/* 変化量							*/
// //
// //	pByte = (uchar *)0;					/* ポインタ初期化					*/
// //	pWord = (ushort *)0;
// //	usMin = (ushort)0;					/* 最小値初期化						*/
// //	usMax = (ushort)0;					/* 最大値初期化						*/
// //	usChg = (ushort)1;					/* 変化量初期化						*/
// //
// //	switch(MTR.MSTS)
// //	{
// //		case MSTS_SETUP:				/* 初期設定							*/
// //			switch(MTR.SSTS)
// //			{
// //				case SSTS_SETUP_AREA:	/* 地域状態							*/
// //					pByte = &FUNC.SETUP.ucAREA;
// //										/* 実体＝地域						*/
// //					if(SYS.INF.COUNTRY == COUNTRY_JP)
// //					{					/* 国内の場合						*/
// //						usMin = (ushort)AREA_HOKKAIDO;
// //										/* 最小値＝北海道(=0)				*/
// //						usMax = (ushort)AREA_OKINAWA;
// //										/* 最大値＝沖縄						*/
// //						if(SYS.INF.SPECB.BIT.WT_100G)
// //						{				/* 最小目量100gの場合				*/
// //							usChg++;	/* 変化量+1							*/
// //						}
// //					}
// //					else				/* その他（海外）の場合				*/
// //					{
// //						usMin = (ushort)AREA_A0;
// //										/* 最小値(0)						*/
// //						usMax = (ushort)AREA_A9;
// //										/* 最大値							*/
// //					}
// //					break;
// //
// //				case SSTS_SETUP_YEAR:	/* 年状態							*/
// //					pWord = &TIME.DATE.usYEAR;
// //										/* 実体＝時計情報の年				*/
// //					usMin = YEAR_SET_MIN;
// //										/* 最小値							*/
// //					usMax = YEAR_SET_MAX;
// //										/* 最大値＝2050年					*/
// //					break;
// //
// //				case SSTS_SETUP_MONTH:	/* 月状態							*/
// //					pByte = &TIME.DATE.ucMONTH;
// //										/* 実体＝時計情報の月				*/
// //					usMin = (ushort)1;	/* 最小値＝1月						*/
// //					usMax = (ushort)12;	/* 最大値＝12月						*/
// //					break;
// //
// //				case SSTS_SETUP_DAY:	/* 日状態							*/
// //					pByte = &TIME.DATE.ucDAY;
// //										/* 実体＝時計情報の日				*/
// //					usMin = (ushort)1;	/* 最小値＝1日						*/
// //					usMax = (ushort)GetDayOfMonth(TIME.DATE.usYEAR,
// //														TIME.DATE.ucMONTH);
// //										/* 最大値＝28～31日					*/
// //					break;
// //
// //				case SSTS_SETUP_HOUR:	/* 時状態							*/
// //					pByte = &TIME.CLOCK.ucHOUR;
// //										/* 実体＝時計情報の時				*/
// //					usMin = (ushort)0;	/* 最小値＝0時						*/
// //					usMax = (ushort)23;	/* 最大値＝23時						*/
// //					break;
// //
// //				case SSTS_SETUP_MIN:	/* 分状態							*/
// //					pByte = &TIME.CLOCK.ucMIN;
// //										/* 実体＝時計情報の分				*/
// //					usMin = (ushort)0;	/* 最小値＝0分						*/
// //					usMax = (ushort)59;	/* 最大値＝59分						*/
// //					break;
// //			}
// //			break;
// //
// //		case MSTS_PSET:					/* 個人設定							*/
// //			switch(MTR.SSTS)
// //			{
// //				case SSTS_PSET_AGE:		/* 年齢状態							*/
// //					pByte = &PSINF.ucAGE;
// //										/* 実体＝年齢						*/
// //					usMin = (ushort)GetAgeMin();
// //										/* 最小値							*/
// //					usMax = (ushort)AGE_MAX_ISCAN;
// //										/* 最大値＝99才						*/
// //					break;
// //
// //				case SSTS_PSET_YEAR:	/* 年状態							*/
// //					pWord = &FUNC.PSET.DOB.usYEAR;
// //										/* 実体＝年							*/
// //					usMin = YEAR_MIN;	/* 最小値＝最大年齢					*/
// //					usMax = TIME.DATE.usYEAR;
// //										/* 最大値＝最小年齢					*/
// //					if(TIME.DATE.usYEAR > YEAR_SET_MAX)
// //					{					/* 最大年を超えている場合			*/
// //						usMax = YEAR_SET_MAX;
// //					}					/* 最大年で丸める					*/
// //					break;
// //
// //				case SSTS_PSET_MONTH:	/* 月状態							*/
// //					pByte = &FUNC.PSET.DOB.ucMONTH;
// //										/* 実体＝月							*/
// //					usMin = (ushort)1;	/* 最小値＝1月						*/
// //					usMax = (ushort)12;	/* 最大値＝12月						*/
// //					break;
// //
// //				case SSTS_PSET_DAY:		/* 日状態							*/
// //					pByte = &FUNC.PSET.DOB.ucDAY;
// //										/* 実体＝日							*/
// //					usMin = (ushort)1;	/* 最小値＝1日						*/
// //					usMax = (ushort)(GetDayOfMonth(FUNC.PSET.DOB.usYEAR,
// //													FUNC.PSET.DOB.ucMONTH));
// //										/* 最大値＝28～31日					*/
// //					break;
// //
// //				case SSTS_PSET_SEX:		/* 性別/体型状態					*/
// //					pByte = &FUNC.PSET.ucFIG;
// //										/* 実体＝性別/体型					*/
// //					usMin = (ushort)FIG_MIN;
// //										/* 最小値設定						*/
// //					usMax = (ushort)FIG_MAX;
// //										/* 最大値設定						*/
// //					if(SYS.INF.SPECB.BIT.ATHLE
// //							&& (ChkAgeAdult(PSINF.ucAGE) != NG))
// //					{
// //						usMax = (ushort)FIG_AT_MAX;
// //					}
// //					break;
// //
// //				case SSTS_PSET_HEIT:	/* 身長状態							*/
// //					pWord = &FUNC.PSET.usHEIT;
// //										/* 実体＝身長						*/
// //					usMin = GetHtMin(SYS.INF.UNIT);
// //										/* 最小値							*/
// //					usMax = GetHtMax(SYS.INF.UNIT);
// //										/* 最大値							*/
// //					if(SYS.INF.UNIT == UNIT_KG)
// //					{
// //						usChg = (ushort)((SYS.INF.COUNTRY == COUNTRY_JP)
// //									? HEIT_CM_NOTCH : HEIT_CM_NOTCH_HI);
// //										/* 変化量							*/
// //						if(TMR.STS[TMR2].usVAL)
// //						{				/* 高速動作の場合					*/
// //							usChg = HEIT_CM_NOTCH_HI;
// //										/* 変化量1.0cm						*/
// //							if((ucType == CNT_DOWN)
// //								&& (FUNC.PSET.usHEIT % HEIT_CM_NOTCH_HI))
// //							{			/* カウントダウンで					*/
// //										/* 0.5cmの端数がある場合			*/
// //								usChg = (ushort)0;
// //										/* 変化量無し						*/
// //							}
// //							FUNC.PSET.usHEIT = (ushort)(
// //									(FUNC.PSET.usHEIT / HEIT_CM_NOTCH_HI)
// //									* HEIT_CM_NOTCH_HI);
// //										/* 1.0cm単位で丸める				*/
// //						}
// //					}
// //					else
// //					{
// //						usChg = HEIT_IN_NOTCH;
// //										/* 変化量							*/
// //					}
// //					break;
// //
// //				case SSTS_PSET_AL:		/* 生活強度状態						*/
// //					pByte = (uchar *)&FUNC.PSET.AL;
// //										/* 実体＝生活強度					*/
// //					usMin = (ushort)AL_LO;
// //										/* 最小値＝0						*/
// //					usMax = (ushort)AL_HI;
// //										/* 最大値＝2						*/
// //					break;
// //
// //				case SSTS_PSET_CLR:		/* 消去選択状態						*/
// //				case SSTS_PSET_DEL_SEL:	/* 削除選択状態						*/
// //					pByte = &FUNC.PSET.ucCLR;
// //										/* 実体＝消去状態					*/
// //					usMin = (ushort)NO;	/* 最小値＝ＮＯ						*/
// //					usMax = (ushort)YES;/* 最大値＝ＹＥＳ					*/
// //					break;
// //			}
// //			break;
// //
// //		case MSTS_MEM:					/* メモリモード						*/
// //			switch(MTR.SSTS)
// //			{
// //				case SSTS_MEM_DSP_ADR:	/* アドレス表示状態					*/
// //					pWord = &FUNC.MEM.usADR;
// //										/* 実体＝メモリアドレス				*/
// //					usMin = MEM_ADR_TOP;/* 最小値＝0						*/
// //					usMax = MEM_ADR_BTM;/* 最大値							*/
// //					usChg = (ushort)0x0002;
// //										/* 変化量＝0x0002					*/
// //key01 del start
// //					if(!(KEY.ucTHIS & KEYBIT_SET))
// //					{					/* SETキー同時押しの場合			*/
// //						usChg = (ushort)0x0020;
// //										/* 変化量＝0x0020					*/
// //						if((ucType == CNT_DOWN) && (FUNC.MEM.usADR & 0x000F))
// //						{				/* カウントダウンで					*/
// //										/* アドレスに端数がある場合			*/
// //							usChg = (ushort)0;
// //										/* 変化量無し						*/
// //						}
// //						FUNC.MEM.usADR &= 0xFFF0;
// //										/* アドレスを0x10単位で丸める		*/
// //					}
// //key01 del end
// //					break;
// //
// //				case SSTS_MEM_EDIT:		/* 編集状態							*/
// //					pByte = &FUNC.MEM.ucEDITDATA[FUNC.MEM.ucEDITFIG];
// //										/* 実体＝メモリ編集データ			*/
// //					usMin = (ushort)0;	/* 最小値＝0						*/
// //					usMax = (ushort)0x000F;
// //										/* 最大値＝0x000F					*/
// //					break;
// //			}
// //			break;
// //
// //ble02 del start
// //		case MSTS_BLETEST:				/* BLE検査モード					*/
// //			switch(MTR.SSTS)
// //			{
// //				case SSTS_BLETEST_SEL_PLACE:
// //										/* 検査場所選択						*/
// //					pByte = &FUNC.TEST.ucCNT;
// //										/* 実体＝カウンタ					*/
// //					usMin = (ushort)BLE_TEST_PCBCHK;
// //										/* 最小値							*/
// //					usMax = (ushort)BLE_TEST_TEST;
// //										/* 最大値							*/
// //					break;
// //
// //				case SSTS_BLETEST_SEL_LNUM:
// //										/* ライン番号選択					*/
// //					pByte = &FUNC.TEST.ucLNUM;
// //										/* 実体＝ライン番号					*/
// //					usMin = (ushort)BLE_TEST_LNUM_MIN;
// //										/* 最小値							*/
// //					usMax = (ushort)BLE_TEST_LNUM_MAX;
// //										/* 最大値							*/
// //					break;
// //			}
// //			break;
// //ble02 del end
// //
// //		default:						/* その他の場合						*/
// //			return;						/* リターン							*/
// //	}
// //
// //	if(usMin <= usMax)					/* 最小値≦最大値の場合				*/
// //	{
// //		if(pByte)						/* 1バイトデータの場合				*/
// //		{
// //			usVal = (ushort)*pByte;		/* 実体取得							*/
// //		}
// //		else if(pWord)					/* 2バイトデータの場合				*/
// //		{
// //			usVal = *pWord;				/* 実体取得							*/
// //		}
// //		else							/* ポインタ未設定の場合				*/
// //		{
// //			return;						/* 演算せずにリターン				*/
// //		}
// //
// //		if(ucType == CNT_DOWN)			/* カウントダウンの場合				*/
// //		{
// //			if((usVal < usChg) || ((usVal - usChg) < usMin))
// //			{							/* 演算結果が最小値未満の場合		*/
// //				usVal = usMax;
// //			}							/* 現在値＝最大値					*/
// //			else
// //			{							/* 演算結果が最小値以上の場合		*/
// //				usVal = (ushort)(usVal - usChg);
// //			}							/* 現在値＝現在値－変化量			*/
// //		}
// //		else							/* カウントアップの場合				*/
// //		{
// //			if((ulong)((ulong)usVal + (ulong)usChg) > (ulong)usMax)
// //			{							/* 演算結果が最大値を超える場合		*/
// //				usVal = usMin;
// //			}							/* 現在値＝最小値					*/
// //			else
// //			{							/* 演算結果が最大値以内の場合		*/
// //				usVal = (ushort)(usVal + usChg);
// //			}							/* 現在値＝現在値＋変化量			*/
// //		}
// //
// //		if(pByte)						/* 1バイトデータの場合				*/
// //		{
// //			*pByte = (uchar)usVal;		/* 実体設定							*/
// //		}
// //		else							/* 2バイトデータの場合				*/
// //		{
// //			*pWord = usVal;				/* 実体設定							*/
// //		}
// //	}
// //}
// //
// //key01 del end

// /****************************************************************************/
// /*																			*/
// /*		関数名			：	LoadPsDat										*/
// /*																			*/
// /*		関数名称		：	測定データロード								*/
// /*																			*/
// /*		作成年月日		：	2010/ 9/30	深田								*/
// /*																			*/
// /*		単体試験履歴	：	2022/  /										*/
// /*																			*/
// /****************************************************************************/
// void	LoadPsDat(enum PSTIME_ID Time)
// {
// 										/* Time	:回数情報					*/

// 	struct	PSMEM_DAT_T	*pPs;			/* 測定データポインタ				*/

// 	if(Time < PSTIME_THIS)				/* 過去データの場合					*/
// 	{
// 		if(SYS.INF.ucPNUM >= PREG_MAX)	/* ゲスト測定の場合					*/
// 		{
// 			return;						/* 処理中断							*/
// 		}
// //err01 chg start
// //		ReqRead(MEM_KIND_PSDAT, PSINF.ucMNG[Time]);
// //										/* 読込(測定データ)					*/
// //		pPs = &PSINF.DAT[ILAST];		/* 測定データポインタ＝過去			*/
// 		for( ; Time < PSTIME_THIS; Time++)
// 		{
// 			ReqRead(MEM_KIND_PSDAT, PSINF.ucMNG[Time]);
// 										/* 読込(測定データ)					*/
// 			pPs = &PSINF.DAT[ILAST];	/* 測定データポインタ＝過去			*/
// 			if((PSINF.ucMNG[Time] < PSTIME_MAX) && (ChkPsDat(pPs) == OK))
// 			{							/* 測定データ(日付・体重）チェック	*/
// 				break;					/* OKの場合、処理中断				*/
// 			}

// 			pPs->REV.usWEIT = (ushort)0;/* 体重なし							*/

// 		}
// //err01 chg end
// 	}
// 	else								/* 今回データの場合					*/
// 	{
// 		pPs = &PSINF.DAT[ITHIS];		/* 測定データポインタ＝今回			*/
// 	}
// //err01 del start
// //	ChkPsDat(pPs);						/* 測定データチェック				*/
// //err01 del end
// 	s_memcpy(&TIME.CLOCK, &pPs->CLOCK, sizeof(TIME.CLOCK));
// 										/* 測定年月日時分秒					*/
// 	PSINF.usHEIT = pPs->usHEIT;			/* 身長								*/
// 	PSINF.ucFIG = pPs->ucFIG;			/* 性別/体型						*/
// 	PSINF.AL = pPs->AL;					/* 生活強度							*/
// //ble01 del start
// //	PSINF.ucPLSMEAS = pPs->ucPLSMEAS;	/* 脈拍測定情報						*/
// //ble01 del end
// 	s_memcpy(&PSINF.usWEIT, &pPs->REV, sizeof(PSINF.REV));
// 										/* 回帰式データ						*/
// 	DecodeDate(&TIME.DATE, TIME.CLOCK.usDATE);
// 										/* 年月日解凍						*/
// 	SetPsAgeLimit(&PSINF.DOB, &PSINF.ucFIG, &PSINF.AL, AGE_MAX);
// 										/* 個人情報年齢制限設定(表示用)		*/
// }
// 

// /****************************************************************************/
// /*																			*/
// /*		関数名			：	SavePsDat										*/
// /*																			*/
// /*		関数名称		：	測定データセーブ								*/
// /*																			*/
// /*		作成年月日		：	2010/ 9/30	深田								*/
// /*																			*/
// /*		単体試験履歴	：	2022/  /										*/
// /*																			*/
// /****************************************************************************/
// uchar	SavePsDat(enum PSTIME_ID Time)
// {
// 										/* Time	:回数情報					*/

// 	uchar	ucRet;						/* 戻り値							*/

// 	ucRet = OK;							/* 戻り値初期化						*/

// 	if(Time == PSTIME_THIS)				/* 今回データの場合					*/
// 	{
// 		s_memcpy(&PSINF.DAT[ITHIS].CLOCK, &TIME.CLOCK,
// 										sizeof(PSINF.DAT[ITHIS].CLOCK));
// 										/* 測定年月日時分秒					*/
// 		PSINF.DAT[ITHIS].usHEIT = PSINF.usHEIT;
// 										/* 身長								*/
// 		PSINF.DAT[ITHIS].ucFIG = PSINF.ucFIG;
// 										/* 性別/体型						*/
// 		PSINF.DAT[ITHIS].AL = PSINF.AL;	/* 生活強度							*/
// 		PSINF.DAT[ITHIS].ucAGE = PSINF.ucAGE;
// 										/* 年齢	※回帰式用(データ送信時使用)*/
// //ble01 chg start
// //		PSINF.DAT[ITHIS].ucPLSMEAS = PSINF.ucPLSMEAS;
// //										/* 脈拍測定情報						*/
// 		PSINF.DAT[ITHIS].usTARE = PSINF.usTARE;
// 										/* 風袋量							*/
// //ble01 chg end
// //step01 chg start
// //		PSINF.DAT[ITHIS].usTEMP = STP.usTEMP[STP_LAST];
// //										/* 温度カウント						*/
// //		PSINF.DAT[ITHIS].usZERO = (ushort)STP.ulZERO[STP_LAST];
// //										/* 0点カウント						*/
// 		PSINF.DAT[ITHIS].usTEMP = MEAS.usTEMP;
// 										/* 温度カウント						*/
// 		PSINF.DAT[ITHIS].usZERO = (ushort)MEAS.ulZERO;
// 										/* 0点カウント						*/
// //step01 chg end
// //ble01 add start
// 		PSINF.DAT[ITHIS].usCNT_WEIT = (ushort)MEAS.ulWEIT;
// 										/* 体重カウント						*/
// 		PSINF.DAT[ITHIS].sTEMP = TMPHMD.DAT.sTEMP;
// 										/* 温度								*/
// 		PSINF.DAT[ITHIS].ucHMD = TMPHMD.DAT.ucHMD;
// 										/* 湿度								*/
// 		PSINF.DAT[ITHIS].usMEASTIME_WEIT = MEAS.usMEASTIME_WEIT;
// 										/* 体重測定時間						*/
// 		PSINF.DAT[ITHIS].usMEASTIME_IMP = MEAS.usMEASTIME_IMP;
// 										/* インピーダンス測定時間			*/
// //ble01 add end
// 		PSINF.DAT[ITHIS].sR50 = MEAS.IMP[IMP_FREQ_50KHZ].sRDT;
// 										/* 50kHzレジスタンス				*/
// 		PSINF.DAT[ITHIS].sX50 = MEAS.IMP[IMP_FREQ_50KHZ].sXDT;
// 										/* 50kHzリアクタンス				*/
// 		PSINF.DAT[ITHIS].sR5 = MEAS.IMP[IMP_FREQ_5KHZ].sRDT;
// 										/* 5kHzレジスタンス					*/
// 		PSINF.DAT[ITHIS].sX5 = MEAS.IMP[IMP_FREQ_5KHZ].sXDT;
// 										/* 5kHzリアクタンス					*/
// 		s_memcpy(&PSINF.DAT[ITHIS].REV, &PSINF.usWEIT, sizeof(PSINF.REV));
// 										/* 回帰式データ						*/
// 	}
// 	else if(SYS.INF.ucPNUM < PREG_MAX)	/* 過去データand個人測定の場合		*/
// 	{
// 		s_memcpy(&PSINF.DAT[ILAST], &PSINF.DAT[ITHIS],
// 						sizeof(PSINF.DAT[ILAST]));
// 										/* 今回データ退避					*/
// 		ShiftPsMng();					/* 個人管理情報シフト				*/
// 		if((SeekPsMng() == NG)
// 			|| (ReqWrite(MEM_KIND_PSDAT, PSINF.ucMNG[PSTIME_LAST1]) == NG)
// //t020 chg start
// //			|| (ReqWrite(MEM_KIND_PSMNG, (uchar)0) == NG))
// 			|| (ReqWrite(MEM_KIND_PSMNG, (uchar)0) == NG)
// 			|| (ReqWrite(MEM_KIND_PSMQS, (uchar)0) == NG))
// //t020 chg end
// 		{								/* 個人管理情報空き検索異常or		*/
// 										/* 書込(測定データ)異常or			*/
// 										/* 書込(管理情報)異常の場合			*/
// 			ucRet = NG;					/* 異常終了							*/
// 		}
// 	}

// 	return(ucRet);						/* 戻り値返却						*/
// }
// 

// /****************************************************************************/
// /*																			*/
// /*		関数名			：	SavePsRev										*/
// /*																			*/
// /*		関数名称		：	回帰式データセーブ								*/
// /*																			*/
// /*		作成年月日		：	2010/ 9/30	深田								*/
// /*																			*/
// /*		単体試験履歴	：	2011/ 1/18	深田								*/
// /*																			*/
// /****************************************************************************/
// void	SavePsRev(void)
// {
// 	s_memcpy(&PSINF.REV, &PSINF.usWEIT, sizeof(PSINF.REV));
// 										/* 回帰式データ退避					*/
// }
// 

// //pset01 del start
// /****************************************************************************/
// /*																			*/
// /*		関数名			：	SetLastPnum										*/
// /*																			*/
// /*		関数名称		：	最終呼出個人番号設定							*/
// /*																			*/
// /*		作成年月日		：	2009/ 5/26	小山								*/
// /*																			*/
// /*		単体試験履歴	：	2011/ 1/18	深田								*/
// /*																			*/
// /****************************************************************************/
// //void	SetLastPnum(void)
// //{
// //	MTR.ucLASTPNUM = (uchar)((SYS.INF.ucPNUM >= PREG_MAX) ?
// //										PNUM_1 : SYS.INF.ucPNUM);
// //										/* 最終呼出個人番号設定				*/
// //}
// //
// //pset01 del end

// /****************************************************************************/
// /*																			*/
// /*		関数名			：	GetPsinf										*/
// /*																			*/
// /*		関数名称		：	個人情報取得									*/
// /*																			*/
// /*		作成年月日		：	2010/10/22	深田								*/
// /*																			*/
// /*		単体試験履歴	：	2018/12/ 6	小山								*/
// /*																			*/
// /****************************************************************************/
// void	GetPsinf(void)
// {
// 	ReqRead(MEM_KIND_PSINF, (uchar)0);	/* 読出要求(個人情報)				*/
// 	ChkPsinf();							/* 個人情報チェック					*/
// 										/* ※年齢(表示用)も設定している		*/
// }
// 

// //item01 del start
// /****************************************************************************/
// /*																			*/
// /*		関数名			：	SetPsdatThis									*/
// /*																			*/
// /*		関数名称		：	今回測定データ設定								*/
// /*																			*/
// /*		作成年月日		：	2013/ 2/ 7	小山								*/
// /*																			*/
// /*		単体試験履歴	：	2019/ 1/11	小山								*/
// /*																			*/
// /****************************************************************************/
// //void	SetPsdatThis(void)
// //{
// //	PSINF.PTR = PSTIME_THIS;			/* 個人データポインタ＝今回			*/
// //	s_memcpy(&TIME.CLOCK, &PSINF.DAT[ITHIS].CLOCK, sizeof(TIME.CLOCK));
// //										/* 測定年月日時分秒					*/
// //	DecodeDate(&TIME.DATE, TIME.CLOCK.usDATE);
// //										/* 年月日解凍						*/
// //	PSINF.usWEIT = PSINF.DAT[ITHIS].REV.usWEIT;
// //										/* 体重								*/
// //}
// //
// //item01 del end

// /****************************************************************************/
// /*																			*/
// /*		関数名			：	ShiftPsMng										*/
// /*																			*/
// /*		関数名称		：	個人管理情報シフト								*/
// /*																			*/
// /*		作成年月日		：	2010/10/ 4	深田								*/
// /*																			*/
// /*		単体試験履歴	：	2011/ 1/18	深田								*/
// /*																			*/
// /****************************************************************************/
// void	ShiftPsMng(void)
// {
// 	uchar	*pMng;						/* 管理情報ポインタ					*/
// 	uchar	ucSize;						/* 管理情報サイズ					*/

// 	pMng = &PSINF.ucMNG[PSTIME_MAX - 1];/* 管理情報ポインタ設定				*/

// 	for(ucSize = (uchar)(PSTIME_MAX - (uchar)1); ucSize > (uchar)0; ucSize--)
// 	{									/* シフト							*/
// 		*pMng = *(pMng - (uchar)1);
// 		pMng--;
// 	}
// 	*pMng = PSBLK_INIT;					/* 先頭データ初期化					*/
// }
// 

// /****************************************************************************/
// /*																			*/
// /*		関数名			：	SeekPsMng										*/
// /*																			*/
// /*		関数名称		：	個人管理情報空き検索							*/
// /*																			*/
// /*		作成年月日		：	2010/10/ 4	深田								*/
// /*																			*/
// /*		単体試験履歴	：	2011/ 1/18	深田								*/
// /*																			*/
// /****************************************************************************/
// uchar	SeekPsMng(void)
// {
// 	uchar	*pMng;						/* 管理情報ポインタ					*/
// 	uchar	ucBlk;						/* ブロック番号						*/
// 	uchar	ucSize;						/* サイズ							*/

// 	for(ucBlk = (uchar)0; ucBlk < PSTIME_MAX; ucBlk++)
// 	{									/* 空きブロック検索					*/
// 		pMng = PSINF.ucMNG;				/* 管理情報ポインタ設定				*/
// 		for(ucSize = (uchar)0; ucSize < PSTIME_MAX; ucSize++)
// 		{								/* 一致ブロック検索					*/
// 			if(*pMng == ucBlk)			/* 一致の場合は使用中ブロック		*/
// 			{
// 				break;
// 			}
// 			pMng++;
// 		}
// 		if(ucSize >= PSTIME_MAX)		/* 不一致の場合は空きブロック		*/
// 		{
// 			PSINF.ucMNG[PSTIME_LAST1] = ucBlk;
// 										/* 個人管理情報更新					*/
// 			return(OK);					/* 正常終了							*/
// 		}
// 	}
// 	return(NG);							/* 空きブロックが無い場合は異常終了	*/
// }
// 

// /* rev01 add start															*/
// //t020 del start
// /****************************************************************************/
// /*																			*/
// /*		関数名			：	GetPsLastNum									*/
// /*																			*/
// /*		関数名称		：	測定データ件数取得								*/
// /*																			*/
// /*		作成年月日		：	2010/ 9/30	深田								*/
// /*																			*/
// /*		単体試験履歴	：	2013/ 3/29	小山								*/
// /*																			*/
// /****************************************************************************/
// //uchar	GetPsLastNum(void)
// //{
// //	uchar	*pMng;						/* 管理ポインタ						*/
// //	uchar	ucNum;						/* 測定データ数						*/
// //
// //	pMng = PSINF.ucMNG;					/* 管理ポインタ初期化				*/
// //
// //	for(ucNum = (uchar)0; ucNum < PSTIME_MAX; ucNum++)
// //	{									/* 測定データ数取得					*/
// //		if(*(pMng++) >= PSTIME_MAX)
// //		{
// //			break;
// //		}
// //	}
// //
// //	return(ucNum);						/* 測定データ数返却					*/
// //}
// //
// //t020 del end
// /****************************************************************************/
// /*																			*/
// /*		関数名			：	ShiftPsDay										*/
// /*																			*/
// /*		関数名称		：	個人日データシフト（筋質点数用）				*/
// /*																			*/
// /*		作成年月日		：	2015/ 2/ 3	小山								*/
// /*																			*/
// /*		単体試験履歴	：	2015/  /										*/
// /*																			*/
// /****************************************************************************/
// void	ShiftPsDay(ushort usThisDate, ushort usLastDate, uchar ucNew)
// {
// 										/* usThisDate	:今回日時			*/
// 										/* usLastDate	:前回日時			*/
// 										/* ucNew		:最新データ			*/

// 	uchar	*pBegin;					/* 開始ポインタ						*/
// 	uchar	*pData;						/* データポインタ					*/
// 	ushort	usShift;					/* シフト量							*/
// 	uchar	ucShift;					/* 実シフト量						*/
// 	uchar	ucCnt;						/* カウンタ							*/
// 	schar	scSign;						/* シフト方向						*/

// 	if(usThisDate <= usLastDate)		/* 過去⇒現在シフト(例外使用)又は	*/
// 	{									/* 同日シフトなしの場合				*/
// 		pBegin = &PSINF.ucMQSDAY[0];	/* ポインタ ＝ 破棄される最新データ	*/
// 		usShift = (ushort)(usLastDate - usThisDate);
// 										/* シフト量の絶対値取得				*/
// 		scSign = (schar)1;				/* シフト方向 ＝ 過去⇒現在			*/
// 	}
// 	else								/* 現在⇒過去シフトの場合(通常使用)	*/
// 	{
// 		pBegin = &PSINF.ucMQSDAY[PSDAY_MAX - 1];
// 										/* ポインタ ＝ 破棄される最古データ	*/
// 		usShift = (ushort)(usThisDate - usLastDate);
// 										/* シフト量の絶対値取得				*/
// 		scSign = (schar)-1;				/* シフト方向 ＝ 現在⇒過去			*/
// 	}

// 	ucShift = (uchar)((usShift > (ushort)PSDAY_MAX) ? PSDAY_MAX : usShift);
// 										/* 実シフト量設定					*/

// 	for(; ucShift > (uchar)0; ucShift--)/* 全サイクルシフト					*/
// 	{
// 		pData = pBegin;					/* 開始ポインタ初期化				*/
// 		for(ucCnt = (uchar)(PSDAY_MAX - (uchar)1); ucCnt > (uchar)0; ucCnt--)
// 		{								/* 1サイクルシフト					*/
// 			*pData = *(pData + scSign);
// 			pData += scSign;
// 		}
// 		*pData = MQSDAY_INIT;			/* 開始データ初期化					*/
// 	}

// 	if((scSign == (schar)-1) && (usShift <= (ushort)PSDAY_MAX))
// 	{									/* 現在⇒過去シフトでシフト範囲内	*/
// 		PSINF.ucMQSDAY[usShift - (ushort)1] = ucNew;
// 										/* 最新データ設定					*/
// 	}
// }
// 

// /****************************************************************************/
// /*																			*/
// /*		関数名			：	ShiftPsWtDay									*/
// /*																			*/
// /*		関数名称		：	個人日データシフト（体重急激増減用）			*/
// /*																			*/
// /*		作成年月日		：	2021/ 9/21	小山								*/
// /*																			*/
// /*		単体試験履歴	：	2021/  /										*/
// /*																			*/
// /****************************************************************************/
// //void	ShiftPsWtDay(ushort usThisDate, ushort usLastDate, ushort usNew)
// //{
// //										/* usThisDate	:今回日時			*/
// //										/* usLastDate	:前回日時			*/
// //										/* usNew		:最新データ			*/
// //
// //	ushort	*pBegin;					/* 開始ポインタ						*/
// //	ushort	*pData;						/* データポインタ					*/
// //	ushort	usShift;					/* シフト量							*/
// //	uchar	ucShift;					/* 実シフト量						*/
// //	uchar	ucCnt;						/* カウンタ							*/
// //	schar	scSign;						/* シフト方向						*/
// //
// //	if(usThisDate <= usLastDate)		/* 過去⇒現在シフト(例外使用)又は	*/
// //	{									/* 同日シフトなしの場合				*/
// //		pBegin = &PSINF.usWTDAY[0];		/* ポインタ ＝ 破棄される最新データ	*/
// //		usShift = (ushort)(usLastDate - usThisDate);
// //										/* シフト量の絶対値取得				*/
// //		scSign = (schar)1;				/* シフト方向 ＝ 過去⇒現在			*/
// //	}
// //	else								/* 現在⇒過去シフトの場合(通常使用)	*/
// //	{
// //		pBegin = &PSINF.usWTDAY[PSWTDAY_MAX - 1];
// //										/* ポインタ ＝ 破棄される最古データ	*/
// //		usShift = (ushort)(usThisDate - usLastDate);
// //										/* シフト量の絶対値取得				*/
// //		scSign = (schar)-1;				/* シフト方向 ＝ 現在⇒過去			*/
// //	}
// //
// //	ucShift = (uchar)((usShift > (ushort)PSWTDAY_MAX) ? PSWTDAY_MAX : usShift);
// //										/* 実シフト量設定					*/
// //
// //	for(; ucShift > (uchar)0; ucShift--)/* 全サイクルシフト					*/
// //	{
// //		pData = pBegin;					/* 開始ポインタ初期化				*/
// //		for(ucCnt = (uchar)(PSWTDAY_MAX - (uchar)1); ucCnt > (uchar)0; ucCnt--)
// //		{								/* 1サイクルシフト					*/
// //			*pData = *(pData + scSign);
// //			pData += scSign;
// //		}
// //		*pData = WTDAY_INIT;			/* 開始データ初期化					*/
// //	}
// //
// //	if((scSign == (schar)-1) && (usShift <= (ushort)PSWTDAY_MAX))
// //	{									/* 現在⇒過去シフトでシフト範囲内	*/
// //		PSINF.usWTDAY[usShift - (ushort)1] = usNew;
// //										/* 最新データ設定					*/
// //	}
// //}
// //
// /* rev01 add end															*/

// /****************************************************************************/
// /*																			*/
// /*		関数名			：	SetAdjLog										*/
// /*																			*/
// /*		関数名称		：	調整ログ設定									*/
// /*																			*/
// /*		作成年月日		：	2010/ 8/25	鈴木								*/
// /*																			*/
// /*		単体試験履歴	：	2011/ 1/18	深田								*/
// /*																			*/
// /****************************************************************************/
// void	SetAdjLog(uchar ucLogNum)
// {
// 										/* ucLogNum	:ログ番号				*/
// 	uchar	ucAdrCnt;					/* アドレスカウンタ					*/

// 	for(ucAdrCnt = (uchar)0; ucAdrCnt < LOG_LEN; ucAdrCnt++)
// 	{
// 		if(SYS.INF.ucADJLOG[ucAdrCnt] == LOG_INIT)
// 		{								/* ログが初期化されている場合		*/
// 			SYS.INF.ucADJLOG[ucAdrCnt] = ucLogNum;
// 										/* 調整ログ格納						*/
// 			if(ucAdrCnt < (uchar)(LOG_LEN - (uchar)1))
// 			{							/* アドレスが最大未満の場合			*/
// 				SYS.INF.ucADJLOG[ucAdrCnt+1] = LOG_INIT;
// 										/* 次のアドレスを初期化				*/
// 			}
// 			else
// 			{							/* その他の場合						*/
// 				SYS.INF.ucADJLOG[0] = LOG_INIT;
// 										/* 先頭アドレスを初期化				*/
// 			}
// 			return;						/* 強制リターン						*/
// 		}
// 	}

// 	SYS.INF.ucADJLOG[0] = ucLogNum;		/* 先頭にログを格納					*/
// 	SYS.INF.ucADJLOG[1] = LOG_INIT;		/* 次のアドレスに初期値を格納		*/
// }
// 


/****************************************************************************/
/*																			*/
/*		関数名			：	s_sqrt											*/
/*																			*/
/*		関数名称		：	平方根計算										*/
/*																			*/
/*		作成年月日		：	2009/ 5/14	小山								*/
/*																			*/
/*		単体試験履歴	：	2010/12/ 7	深田								*/
/*																			*/
/****************************************************************************/
ushort	s_sqrt(ulong ulIn)
{
										/* ulIn	:入力値						*/

	uchar	ucCnt;						/* ローカルカウンタ					*/
	ulong	ulLast;						/* 前回値							*/
	ulong	ulThis;						/* 今回値							*/

	if(ulIn > (ulong)4294770690)		/* 大きすぎる(65534.5^2より大きい)	*/
	{									/* 場合は即リターン					*/
		return((ushort)65535);
	}
	else if(!ulIn)						/* 0入力の場合は0返却				*/
	{
		return((ushort)0);
	}

	ulThis = ulIn;						/* ニュートン法を用いる				*/

	for(ucCnt = (uchar)0; ucCnt < (uchar)30; ucCnt++)
	{
		ulLast = ulThis;
		ulThis = (ulong)(((ulIn / ulLast) + ulLast) / (ulong)2);
		if(ulLast <= ulThis)
		{
			ulThis = ulLast;
			break;
		}
	}
	return((ushort)ulThis);				/* 平方根を返却						*/
}